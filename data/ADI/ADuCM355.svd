# ADuCM355 register map
Vendor: Analog Devices; Series: ADuCM355; File version: 1p0
ARM Cortex-CM3 Microcontroller based device
CPU: CM3 r0p1, little endian, no MPU, no FPU, 3 interrupt priority bits
Registers are 32-bit, read-write, reset 0x0 unless marked. A register's access mark holds for its fields unless they carry their own. Offsets are from the block's base; lines under a group give offsets from that group; [hi:lo] are bit positions; {n}, {i} and the like mark numbered series; 'fields as' and 'values as' point back to an identical list; <NAME> marks a mode.

## Memory map
0x40000000 TMR0 size 0x40 — General Purpose Timer
0x40000400 TMR1 size 0x40
0x40000800 TMR2 size 0x40
0x40001000 RTC0 size 0x100 — Real-Time Clock
0x40001400 RTC1 size 0x100
0x40002000 SYS size 0x80 — System Identification and Debug Enable
0x40002C00 WDT0 size 0x20 — Watchdog Timer
0x40003000 I2C0 size 0x80 — I2C Master/Slave
0x40004000 SPI0 size 0x100 — Serial Peripheral Interface
0x40005000 UART0 size 0x100
0x40010000 DMA0 size 0x1000 — DMA
0x40018000 FLCC0 size 0x100 — Flash Controller
0x40018058 FLCC0_CACHE size 0x100 — Cache Controller
0x40020000 GPIO0 size 0x4000
0x40020040 GPIO1 size 0x4000
0x40020080 GPIO2 size 0x4000
0x40024000 SPI2 size 0x100
0x40040000 CRC0 size 0x100 — CRC Accelerator
0x40040400 RNG0 size 0x100 — Random Number Generator
0x40044000 CRYPT0 size 0x80 — Cryptogaphic
0x4004C000 PMG0 size 0x4000 — Power Management
0x4004C080 XINT0 size 0x4000 — External interrupt configuration
0x4004C100 CLKG0_OSC size 0x4000 — Clocking
0x4004C200 PMG0_TST size 0x4000 — Power Management
0x4004C300 CLKG0_CLK size 0x4000 — Clocking
0x4004C800 BUSM0 size 0x4000 — Bus matrix
0x400C0080 AGPIO2 size 0x40
0x400C0400 AFECON size 0x100
0x400C0900 AFEWDT size 0x100
0x400C0A00 ALLON size 0x100 — Always On Register
0x400C0D00 AGPT0 size 0x40 — General Purpose Timer
0x400C0E00 AGPT1 size 0x40 — General Purpose Timer
0x400C1000 AFECRC size 0x100 — CRC Accelerator
0x400C2000 AFE size 0x800
0xE000E000 NVIC0 size 0x1000 — Cortex-M3 Interrupt Controller

## Interrupts
0 RTC1_EVT (RTC1) — Event
2 XINT_EVT1 (XINT0) — External Wakeup Interrupt n
4 AFE_EVT3 (XINT0) — AFE Interrupt
5 WDT_EXP (WDT0) — Digital Die Watchdog
6 PMG0_VREG_OVR (PMG0) — Voltage Regulator (VREG) Overvoltage
7 PMG0_BATT_RANGE (PMG0) — Battery Voltage (VBAT) Out of Range
8 RTC0_EVT (RTC0) — RTC0 Event
9 SYS_GPIO_INTA (SYS) — GPIO Interrupt A
10 SYS_GPIO_INTB (SYS) — GPIO Interrupt B
11 TMR0_EVT (TMR0) — Event
12 TMR1_EVT (TMR1) — Event
14 UART_EVT (UART0) — Event
15 SPI0_EVT (SPI0) — Event
17 I2C_SLV_EVT (I2C0) — Slave Event
18 I2C_MST_EVT (I2C0) — Master Event
19 DMA_CHAN_ERR (DMA0) — DMA Error
20 DMA0_CH0_DONE (DMA0) — Channel SPI1_TX Done
21 DMA0_CH1_DONE (DMA0) — Channel SPI1_RX Done
22 DMA0_CH2_DONE (DMA0) — Channel 2 Done
23 DMA0_CH3_DONE (DMA0) — Channel 3 Done
24 DMA0_CH4_DONE (DMA0) — Channel SPI0_TX Done
25 DMA0_CH5_DONE (DMA0) — Channel SPI0_RX Done
26 DMA0_CH6_DONE (DMA0) — Channel 6 Done
27 DMA0_CH7_DONE (DMA0) — Channel 7 Done
28 DMA0_CH8_DONE (DMA0) — Channel UART_TX Done
29 DMA0_CH9_DONE (DMA0) — Channel UART_RX Done
30 DMA0_CH10_DONE (DMA0) — Channel I2C0_STX Done
31 DMA0_CH11_DONE (DMA0) — Channel I2C0_SRX Done
32 DMA0_CH12_DONE (DMA0) — Channel I2C0_MX Done
33 DMA0_CH13_DONE (DMA0) — Channel AES_IN_Done
34 DMA0_CH14_DONE (DMA0) — Channel AES_OUT_Done
35 DMA0_CH15_DONE (DMA0) — Channel FLASH0_Done
38 CRYPT_EVT (CRYPT0) — Event
40 TMR2_EVT (TMR2) — Event
44 RNG0_EVT (RNG0)
47 AFE_ERROR (AFE)
48 AFE_ADC (AFE)
49 AFE_GEN (AFE)
50 AFE_CMDFIFO (AFE)
51 AFE_DATAFIFO (AFE)
52 AFE_Watchdog (AFE)
53 AFE_CRC (AFE)
54 AFE_GPT0 (AFE)
55 AFE_GPT1 (AFE)
56 DMA0_CH16_DONE (DMA0) — AFE_DMA_CMDFIFO
57 DMA0_CH17_DONE (DMA0) — AFE_DMA_DATAFIFO
58 DMA0_CH18_DONE (DMA0) — Channel 18 Done
59 DMA0_CH19_DONE (DMA0) — Channel 19 Done
60 DMA0_CH20_DONE (DMA0) — Channel 20 Done
61 DMA0_CH21_DONE (DMA0) — Channel 21 Done
62 DMA0_CH22_DONE (DMA0) — Channel 22 Done
63 DMA0_CH23_DONE (DMA0) — Channel 23 Done
64 AGPT0_EVT (AGPT0)
65 AGPT1_EVT (AGPT1)

## Licence text in the file
ARM Limited (ARM) is supplying this software for use with Cortex-M processor based microcontroller, but can be equally used for other suitable processor architectures. This file can be freely distributed. Modifications to this file shall be clearly marked. THIS SOFTWARE IS PROVIDED "AS IS". NO WARRANTIES, WHETHER EXPRESS, IMPLIED OR STATUTORY, INCLUDING, BUT NOT LIMITED TO, IMPLIED WARRANTIES OF MERCHANTABILITY AND FITNESS FOR A PARTICULAR PURPOSE APPLY TO THIS SOFTWARE. ARM SHALL NOT, IN ANY CIRCUMSTANCES, BE LIABLE FOR SPECIAL, INCIDENTAL, OR CONSEQUENTIAL DAMAGES, FOR ANY REASON WHATSOEVER.

## Notices in the file
Copyright (c) 2016-2019 Analog Devices, Inc.  All Rights Reserved.
This software is proprietary and confidential to Analog Devices, Inc.
and its licensors.
