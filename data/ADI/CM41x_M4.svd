# CM41x_M4 register map
Vendor: Analog Devices; Series: CM41x_M4; File version: 1p0
ARM Cortex-CM4 Microcontroller based device
CPU: CM4 r0p1, little endian, MPU, FPU, 4 interrupt priority bits
Registers are 32-bit, read-write, reset 0x0 unless marked. A register's access mark holds for its fields unless they carry their own. Offsets are from the block's base; lines under a group give offsets from that group; [hi:lo] are bit positions; {n}, {i} and the like mark numbered series; 'fields as' and 'values as' point back to an identical list; <NAME> marks a mode.

## Memory map
0x40000000 SYSBLK1 size 0x1000 — Pads Controller
0x40001000 PADS1 size 0x1000 — Pads Controller
0x40002000 EMUID0 size 0x100 — CHIP ID For ARM Emulators
0x40003000 PINT1 size 0x40
0x40004000 PINT2 size 0x40
0x40005000 PINT3 size 0x40
0x40006000 PINT4 size 0x40
0x40007000 PINT5 size 0x40
0x40008000 PORTB size 0x80 — The General-Purpose Input/Output Port
0x40009000 PORTC size 0x80
0x4000A000 PORTD size 0x80
0x4000B000 PORTE size 0x80
0x4000C000 PORTF size 0x80
0x4000F000 LBA0 size 0x1000 — Logic Block Array
0x40010000 SEC1 size 0x1000 — System Event Controller
0x40011000 WDOG1 size 0x1000
0x40012000 RCU0 size 0x1000 — Reset Control Unit
0x40013000 DPM0 size 0x100 — Dynamic Power Management
0x40014000 CGU0 size 0x80 — Clock Generation Unit
0x40015000 OCU0 size 0x1000 — Oscillator Comparator Unit
0x40017000 TAPC size 0x1000
0x40020000 TRU1 size 0x800 — Trigger Routing Unit
0x40021000 TIMER1 size 0x400
0x40022000 CNT0 size 0x100 — CNT
0x40023000 TWI0 size 0x100 — Two-Wire Interface
0x40024200 CAN1 size 0x1000
0x40025000 CPTMR0 size 0x1000 — Capture Timer
0x40028000 PWM0 size 0x400 — Pulse-Width Modulator
0x40029000 PWM1 size 0x400
0x4002A000 PWM2 size 0x400
0x4002C000 TTU0 size 0x800 — Trigger Timing Unit
0x4002F000 SMC0 size 0x80 — Static Memory Controller
0x40040000 SPI1 size 0x80
0x40042000 SPORT0 size 0x100 — Serial Port
0x40044000 UART1 size 0x40
0x40045000 UART2 size 0x40
0x40046000 UART3 size 0x40
0x40047000 UART4 size 0x40
0x40048000 FFTB0 size 0x1000 — FFTB register map.
0x40049000 SINC0 size 0x100 — SINC
0x4004A000 ADCC1 size 0x800
0x4004B000 DACC0 size 0x200 — DAC Controller
0x4004C000 CRC0 size 0x100 — Cyclic Redundancy Check Unit
0x40050000 HAE0 size 0x8000 — Harmonic Analysis Engine
{0x4005C000+0x1000*n} DMA{n} size 0x200 (n=4..11)
0x40068000 DMA12 size 0x200 — The Direct Memory Access module
0x40069000 DMA13 size 0x200
0x400D1000 MBOX0_PORT1 size 0x1000 — MBOX Port 1 register map
0x400E0000 SMPU1 size 0x1000 — The System Memory Protection Unit
0x400E1000 SMPU2 size 0x1000 — The System Memory Protection Unit
0x400F0000 SWU2 size 0x100
0x400F1000 SWU3 size 0x100
0x400F2000 SWU4 size 0x100
0x400F3000 SWU5 size 0x100
0x400F4000 SWU6 size 0x100
0x400F8000 SPU1 size 0x2000 — System Protection Unit
0x41000000 SYSBLK0 size 0x1000 — Pads Controller
0x41001000 PADS0 size 0x1000 — Pads Controller
0x41002000 PINT0 size 0x40 — The Pin Interrupt module
0x41003000 PORTA size 0x80 — The General-Purpose Input/Output Port
0x41004000 SEC0 size 0x1000 — System Event Controller
0x41005000 WDOG0 size 0x1000 — Watchdog Timer Unit
0x41006000 TRU0 size 0x800 — Trigger Routing Unit
0x41007000 TIMER0 size 0x400 — General-Purpose Timer Block
0x41008200 CAN0 size 0x1000 — Controller Area Network
0x41009000 SPI0 size 0x80 — Serial Peripheral Interface
0x4100A000 UART0 size 0x40 — UART
0x4100B000 ADCC0 size 0x800 — ADC Controller
0x4100C000 DMA0 size 0x200 — The Direct Memory Access module
0x4100D000 DMA1 size 0x200
0x4100E000 DMA2 size 0x200
0x4100F000 DMA3 size 0x200
0x410E0000 SMPU0 size 0x1000 — The System Memory Protection Unit
0x410F0000 SWU0 size 0x100 — System Watchpoint Unit
0x410F1000 SWU1 size 0x100
0x410F8000 SPU0 size 0x2000 — System Protection Unit
0x4F000000 SCB0 size 0x80000 — System Crossbar
0xE000E000 SCS0 size 0x1000
0xE0040000 TRACE0 size 0x1000 — Trace Port Interface Unit
0xE0044000 CXTMC0 size 0x1000 — CoreSight TMC
0xE0048000 CTI0 size 0x1000 — CSCTI_Register_Definitions
0xE0049000 CTI1 size 0x1000 — CSCTI_Register_Definitions
0xE004A000 CTI2 size 0x1000 — CSCTI_Register_Definitions
0xE004B000 CTI3 size 0x1000 — CSCTI_Register_Definitions
0xF8008000 M4P size 0x1000 — ARM Cortex-M4 Platform
0xF8009000 MATH0 size 0x1000 — Math Unit Function
0xF8010000 FLC0 size 0x80 — Flash Controller
0xF8011000 FLC1 size 0x80

## Interrupts
3 CGU0_OSCW_INT (CGU0) — Oscillator Watchdog Interrupt
4 OCU0_ERR (OCU0) — Freq. out-of-range, or dead clock, or counter overflow detected
5 M4P_BCODE_ERR (M4P) — Boot Code CRC Error
6 CTI0_EVT0 (CTI0) — Cross Trigger Interface Event 0
7 CTI0_EVT1 (CTI0) — Cross Trigger Interface Event 1
8 CTI0_EVT2 (CTI0) — Cross Trigger Interface Event 2
9 M4P_LOCKUP (M4P) — Lockup Error (Fault only; not an interrupt)
10 M4P_BUS_FAULT (M4P) — Bus Fault
12 SPU1_TIMEOUT (SPU1) — Timeout Interrupt
13 SYSBLK1_BUS_TIMEOUT (SYSBLK1) — Bus Timeout
14 M4P_CORE_SRAM_EERR (M4P) — SRAM Core ECC Error
15 M4P_DMA_SRAM_EERR (M4P) — SRAM DMA ECC Error
16 FLC0_CORE_FLASH_EERR (FLC0) — Flash Core ECC Error
17 FLC0_DMA_FLASH_EERR (FLC0) — Flash DMA ECC Error
18 FLC0_FLASH_EVT (FLC0) — Flash Event
22 FFTB0_SPERR (FFTB0) — Parity error in the limit buffer (LBUFF), or the window buffer (WNDBUFF). If this interrupt request is asserted, ignore the result of this spectrum capture sequence and rewrite both LBUFF and WNDBUFF.
23 FFTB0_DPERR (FFTB0) — Data parity error
24 HAE0_PERR (HAE0) — Parity Error
27 SPU0_TIMEOUT (SPU0) — Timeout Interrupt
28 SYSBLK0_BUS_TIMEOUT (SYSBLK0) — Bus Timeout
29 SYSBLK0_POSTWR_ERR (SYSBLK0) — Posted Write Error
30 CGU0_EVT (CGU0) — Event
31 DPM0_EVT (DPM0) — Event
32 SEC1_ERR (SEC1) — Error
33 SEC0_ERR (SEC0) — Error
34 WDOG1_EXP (WDOG1) — Expiration
35 WDOG0_EXP (WDOG0) — Expiration
36 TAPC_KEYFAIL (TAPC) — User Key Fail Interrupt
39 PWM0_TRIP (PWM0) — Trip
40 PWM1_TRIP (PWM1) — Trip
41 PWM2_TRIP (PWM2) — Trip
42 SMPU1_ERR (SMPU1) — Error Interrupt
43 SMPU2_ERR (SMPU2) — Error Interrupt
44 SMPU0_ERR (SMPU0) — Error Interrupt
45 SPU1_INT (SPU1) — Interrupt
46 SPU0_INT (SPU0) — Interrupt
47 SWU2_EVT (SWU2) — Event
48 SWU3_EVT (SWU3) — Event
49 SWU4_EVT (SWU4) — Event
50 SWU5_EVT (SWU5) — Event
51 SWU6_EVT (SWU6) — Event
52 SWU0_EVT (SWU0) — Event
53 SWU1_EVT (SWU1) — Event
54 CPTMR0_CPT0_ERR (CPTMR0) — CPT 0 Error Interrupt
55 CPTMR0_CPT1_ERR (CPTMR0) — CPT 1 Error Interrupt
56 CPTMR0_CPT2_ERR (CPTMR0) — CPT 2 Error Interrupt
57 CRC0_ERR (CRC0) — Error
58 SPI1_ERR (SPI1) — Error
59 SPI0_ERR (SPI0) — Error
60 FFTB0_LIMERR (FFTB0) — One or more points in the power spectrum output exceeded the predefined limit in the limit buffer.
61 MATH0_MSTAT (MATH0) — MATH unit Accumulate Interrupt Status
62 ADCC1_ERR (ADCC1) — ADC Error
63 DACC0_ERR (DACC0) — DAC Error
64 ADCC0_ERR (ADCC0) — ADC Error
{n+61} DMA{n}_ERR (DMA{n}) (n=4..13) — Error interrupt
75 DMA0_ERR (DMA0) — Error interrupt
76 DMA1_ERR (DMA1) — Error interrupt
77 DMA2_ERR (DMA2) — Error interrupt
78 DMA3_ERR (DMA3) — Error interrupt
79 PWM0_SYNC (PWM0) — PWMTMR Grouped
80 PWM1_SYNC (PWM1) — PWMTMR Grouped
81 PWM2_SYNC (PWM2) — PWMTMR Grouped
82 PINT1_BLOCK (PINT1) — Pin Interrupt Block
83 PINT2_BLOCK (PINT2) — Pin Interrupt Block
84 PINT3_BLOCK (PINT3) — Pin Interrupt Block
85 PINT4_BLOCK (PINT4) — Pin Interrupt Block
86 PINT5_BLOCK (PINT5) — Pin Interrupt Block
87 PINT0_BLOCK (PINT0) — Pin Interrupt Block
{n+88} TIMER1_TMR{n} (TIMER1) (n=0..7) — Timer {n}
{n+96} TIMER0_TMR{n} (TIMER0) (n=0..7) — Timer {n}
104 TIMER1_STAT (TIMER1) — Status
105 TIMER0_STAT (TIMER0) — Status
106 CPTMR0_CPT0_MEAS (CPTMR0) — CPT 0 Measure Interrupt
107 CPTMR0_CPT1_MEAS (CPTMR0) — CPT 1 Measure Interrupt
108 CPTMR0_CPT2_MEAS (CPTMR0) — CPT 2 Measure Interrupt
{n+105} DMA{n}_INT (DMA{n}) (n=4..13) — Done interrupt
119 DMA0_INT (DMA0) — Done interrupt
120 DMA1_INT (DMA1) — Done interrupt
121 DMA2_INT (DMA2) — Done interrupt
122 DMA3_INT (DMA3) — Done interrupt
123 TRU1_INT0 (TRU1) — Interrupt request 0
124 TRU1_INT1 (TRU1) — Interrupt request 1
125 TRU1_INT2 (TRU1) — Interrupt request 2
126 TRU1_INT3 (TRU1) — Interrupt request 3
127 TRU0_INT0 (TRU0) — Interrupt request 0
128 FFTB0_DONE (FFTB0) — Non-continuous FFT averaging has completed. In addition, the interrupt request is asserted after a channel frame is processed (FFT, PSD, Averaging, PSD comparison) in multichannel mode.
129 ADCC1_TMR0_EVT (ADCC1) — Timer 0 Event Complete
130 ADCC1_TMR1_EVT (ADCC1) — Timer 1 Event Complete
131 ADCC0_TMR0_EVT (ADCC0) — Timer 0 Event Complete
132 ADCC0_TMR1_EVT (ADCC0) — Timer 1 Event Complete
133 DACC0_DAC0 (DACC0) — DAC Interrupt 0
134 DACC0_DAC1 (DACC0) — DAC Interrupt 1
135 SPI1_STAT (SPI1) — Status
136 SPI0_STAT (SPI0) — Status
137 SPORT0_A_STAT (SPORT0) — Channel A Status
138 SPORT0_B_STAT (SPORT0) — Channel B Status
139 UART1_STAT (UART1) — Status
140 UART2_STAT (UART2) — Status
141 UART3_STAT (UART3) — Status
142 UART4_STAT (UART4) — Status
143 UART0_STAT (UART0) — Status
144 HAE0_STAT (HAE0) — Status
145 CRC0_DCNTEXP (CRC0) — Data count expiration
146 CAN1_TX (CAN1) — Transmit
147 CAN1_RX (CAN1) — Receive
148 CAN1_STAT (CAN1) — Status
149 CAN0_TX (CAN0) — Transmit
150 CAN0_RX (CAN0) — Receive
151 CAN0_STAT (CAN0) — Status
152 CNT0_STAT (CNT0) — Status
153 SINC0_STAT (SINC0) — Status
154 TWI0_DATA (TWI0) — Data Interrupt
157 LBA0_SYS_OUT0 (LBA0) — Registered LBA outputs available to system
158 M4P_SOFT_INT0 (M4P) — Software Interrupt 0
159 M4P_SOFT_INT1 (M4P) — Software Interrupt 1
160 M4P_SOFT_INT2 (M4P) — Software Interrupt 2
161 M4P_SOFT_INT3 (M4P) — Software Interrupt 3
162 M4P_SOFT_INT4 (M4P) — Software Interrupt 4
163 M4P_SOFT_INT5 (M4P) — Software Interrupt 5

## Licence text in the file
ARM Limited (ARM) is supplying this software for use with Cortex-M processor based microcontroller, but can be equally used for other suitable processor architectures. This file can be freely distributed. Modifications to this file shall be clearly marked. THIS SOFTWARE IS PROVIDED "AS IS". NO WARRANTIES, WHETHER EXPRESS, IMPLIED OR STATUTORY, INCLUDING, BUT NOT LIMITED TO, IMPLIED WARRANTIES OF MERCHANTABILITY AND FITNESS FOR A PARTICULAR PURPOSE APPLY TO THIS SOFTWARE. ARM SHALL NOT, IN ANY CIRCUMSTANCES, BE LIABLE FOR SPECIAL, INCIDENTAL, OR CONSEQUENTIAL DAMAGES, FOR ANY REASON WHATSOEVER.

## Notices in the file
Copyright (c) 2013-2018 Analog Devices, Inc.  All Rights Reserved.
This software is proprietary and confidential to Analog Devices, Inc.
and its licensors.
