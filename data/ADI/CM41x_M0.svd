# CM41x_M0 register map
Vendor: Analog Devices; Series: CM41x_M0; File version: 1p0
ARM Cortex-CM0 Microcontroller based device
CPU: CM0 r0p0, little endian, MPU, FPU, 4 interrupt priority bits
Registers are 32-bit, read-write, reset 0x0 unless marked. A register's access mark holds for its fields unless they carry their own. Offsets are from the block's base; lines under a group give offsets from that group; [hi:lo] are bit positions; {n}, {i} and the like mark numbered series; 'fields as' and 'values as' point back to an identical list; <NAME> marks a mode.

## Memory map
0x40000000 SYSBLK1 size 0x1000 — Pads Controller
0x40001000 PADS1 size 0x1000 — Pads Controller
0x40002000 EMUID0 size 0x100 — CHIP ID For ARM Emulators
0x40003000 PINT1 size 0x40
0x40004000 PINT2 size 0x40
0x40005000 PINT3 size 0x40
0x40006000 PINT4 size 0x40
0x40007000 PINT5 size 0x40
0x40008000 PORTB size 0x80 — The General-Purpose Input/Output Port
0x40009000 PORTC size 0x80
0x4000A000 PORTD size 0x80
0x4000B000 PORTE size 0x80
0x4000C000 PORTF size 0x80
0x4000F000 LBA0 size 0x1000 — Logic Block Array
0x40010000 SEC1 size 0x1000 — System Event Controller
0x40011000 WDOG1 size 0x1000
0x40012000 RCU0 size 0x1000 — Reset Control Unit
0x40013000 DPM0 size 0x100 — Dynamic Power Management
0x40014000 CGU0 size 0x80 — Clock Generation Unit
0x40015000 OCU0 size 0x1000 — Oscillator Comparator Unit
0x40017000 TAPC size 0x1000
0x40020000 TRU1 size 0x800 — Trigger Routing Unit
0x40021000 TIMER1 size 0x400
0x40022000 CNT0 size 0x100 — CNT
0x40023000 TWI0 size 0x100 — Two-Wire Interface
0x40024200 CAN1 size 0x1000
0x40025000 CPTMR0 size 0x1000 — Capture Timer
0x40028000 PWM0 size 0x400 — Pulse-Width Modulator
0x40029000 PWM1 size 0x400
0x4002A000 PWM2 size 0x400
0x4002C000 TTU0 size 0x800 — Trigger Timing Unit
0x4002F000 SMC0 size 0x80 — Static Memory Controller
0x40040000 SPI1 size 0x80
0x40042000 SPORT0 size 0x100 — Serial Port
0x40044000 UART1 size 0x40
0x40045000 UART2 size 0x40
0x40046000 UART3 size 0x40
0x40047000 UART4 size 0x40
0x40048000 FFTB0 size 0x1000 — FFTB register map.
0x40049000 SINC0 size 0x100 — SINC
0x4004A000 ADCC1 size 0x800
0x4004B000 DACC0 size 0x200 — DAC Controller
0x4004C000 CRC0 size 0x100 — Cyclic Redundancy Check Unit
0x40050000 HAE0 size 0x8000 — Harmonic Analysis Engine
{0x4005C000+0x1000*n} DMA{n} size 0x200 (n=4..11)
0x40068000 DMA12 size 0x200 — The Direct Memory Access module
0x40069000 DMA13 size 0x200
0x400D0000 MBOX0_PORT0 size 0x1000 — MBOX Port 0 register map
0x400D1000 MBOX0_PORT1 size 0x1000 — MBOX Port 1 register map
0x400E0000 SMPU1 size 0x1000 — The System Memory Protection Unit
0x400E1000 SMPU2 size 0x1000 — The System Memory Protection Unit
0x400F0000 SWU2 size 0x100
0x400F1000 SWU3 size 0x100
0x400F2000 SWU4 size 0x100
0x400F3000 SWU5 size 0x100
0x400F4000 SWU6 size 0x100
0x400F8000 SPU1 size 0x2000 — System Protection Unit
0x41000000 SYSBLK0 size 0x1000 — Pads Controller
0x41001000 PADS0 size 0x1000 — Pads Controller
0x41002000 PINT0 size 0x40 — The Pin Interrupt module
0x41003000 PORTA size 0x80 — The General-Purpose Input/Output Port
0x41004000 SEC0 size 0x1000 — System Event Controller
0x41005000 WDOG0 size 0x1000 — Watchdog Timer Unit
0x41006000 TRU0 size 0x800 — Trigger Routing Unit
0x41007000 TIMER0 size 0x400 — General-Purpose Timer Block
0x41008200 CAN0 size 0x1000 — Controller Area Network
0x41009000 SPI0 size 0x80 — Serial Peripheral Interface
0x4100A000 UART0 size 0x40 — UART
0x4100B000 ADCC0 size 0x800 — ADC Controller
0x4100C000 DMA0 size 0x200 — The Direct Memory Access module
0x4100D000 DMA1 size 0x200
0x4100E000 DMA2 size 0x200
0x4100F000 DMA3 size 0x200
0x410E0000 SMPU0 size 0x1000 — The System Memory Protection Unit
0x410F0000 SWU0 size 0x100 — System Watchpoint Unit
0x410F1000 SWU1 size 0x100
0x410F8000 SPU0 size 0x2000 — System Protection Unit
0xE0001000 DWT1 size 0x100 — Data watchpoint unit
0xE0002000 BKPT1 size 0x100 — Breakpoint unit
0xE000E000 SCS1 size 0x800 — NVIC and SysTick
0xE000ED00 SDCTRL size 0x100 — System and Debug Control

## Interrupts
0 SHARED_IRQ0 (CGU0) — Oscillator Watchdog Interrupt
3 SHARED_IRQ3 (SYSBLK0) — Bus Timeout
5 SHARED_IRQ5 (SYSBLK1) — Bus Timeout
6 SHARED_IRQ6 (FFTB0) — Data parity error
7 SHARED_IRQ7 (DPM0) — Event
8 SHARED_IRQ8 (SEC0) — Error
9 WDOG0_EXP (WDOG0) — Expiration
11 SHARED_IRQ11 (SWU0) — Event
12 SHARED_IRQ12 (DMA0) — Error interrupt
13 ADCC0_ERR (ADCC0) — ADC Error
14 PINT0_BLOCK (PINT0) — Pin Interrupt Block
15 SHARED_IRQ15 (TIMER0) — Status
16 SHARED_IRQ16 (CPTMR0) — CPT 0 Measure Interrupt
17 SHARED_IRQ17 (DMA0) — Done interrupt
18 SHARED_IRQ18 (DMA1) — Done interrupt
19 SHARED_IRQ19 (DMA8) — Done interrupt
20 TRU0_INT1 (TRU0) — Interrupt request 1
21 TRU1_INT4 (TRU1) — Interrupt request 4
22 SHARED_IRQ22 (FFTB0) — Non-continuous FFT averaging has completed. In addition, the interrupt request is asserted after a channel frame is processed (FFT, PSD, Averaging, PSD comparison) in multichannel mode.
23 ADCC0_TMR0_EVT (ADCC0) — Timer 0 Event Complete
24 ADCC0_TMR1_EVT (ADCC0) — Timer 1 Event Complete
25 SHARED_IRQ25 (SPI0) — Error
26 UART0_STAT (UART0) — Status
27 HAE0_STAT (HAE0) — Status
28 SHARED_IRQ28 (CAN0) — Receive
29 TWI0_DATA (TWI0) — Data Interrupt

## Licence text in the file
ARM Limited (ARM) is supplying this software for use with Cortex-M processor based microcontroller, but can be equally used for other suitable processor architectures. This file can be freely distributed. Modifications to this file shall be clearly marked. THIS SOFTWARE IS PROVIDED "AS IS". NO WARRANTIES, WHETHER EXPRESS, IMPLIED OR STATUTORY, INCLUDING, BUT NOT LIMITED TO, IMPLIED WARRANTIES OF MERCHANTABILITY AND FITNESS FOR A PARTICULAR PURPOSE APPLY TO THIS SOFTWARE. ARM SHALL NOT, IN ANY CIRCUMSTANCES, BE LIABLE FOR SPECIAL, INCIDENTAL, OR CONSEQUENTIAL DAMAGES, FOR ANY REASON WHATSOEVER.

## Notices in the file
Copyright (c) 2013-2018 Analog Devices, Inc.  All Rights Reserved.
This software is proprietary and confidential to Analog Devices, Inc.
and its licensors.
