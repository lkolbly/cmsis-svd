# MPS3_SSE_200 register map
Vendor: ARM Ltd.; Series: ARMv8-M Mainline; File version: 1.0
ARM 32-bit v8-M Mainline based device
CPU: CM33 r0p2, little endian, MPU, no FPU, 4 interrupt priority bits, 8 SAU regions
Registers are 32-bit, read-write, reset 0x0 unless marked. A register's access mark holds for its fields unless they carry their own. Offsets are from the block's base; lines under a group give offsets from that group; [hi:lo] are bit positions; {n}, {i} and the like mark numbered series; 'fields as' and 'values as' point back to an identical list; <NAME> marks a mode.

## Memory map
0x40000000 TIMER0 size 0x10
0x40001000 TIMER1 size 0x10
0x40002000 DUALTIMER size 0x3C
0x4002F000 S32KTIMER size 0x10
0x40080000 NSPCTRL size 0x1000 — Non-secure Privilege Control Block
0x40081000 WATCHDOG size 0xC04 — Non-secure Watchdog Timer
0x41100000 GPIO0 size 0x3C — General-purpose I/O 0
0x41101000 GPIO1 size 0x3C — General-purpose I/O 1
0x41102000 GPIO2 size 0x3C — General-purpose I/O 2
0x41103000 GPIO3 size 0x3C — General-purpose I/O 3
0x41200000 I2C0 size 0xC
0x41201000 I2C1 size 0xC
0x41202000 SSP0 size 0x40 — SPI 0
0x41203000 SSP1 size 0x40 — SPI 1
0x41204000 SSP2 size 0x40 — SPI 2
0x41205000 I2C2 size 0xC
0x41206000 I2C3 size 0xC
0x41208000 I2C4 size 0xC
0x41300000 SCC size 0x1000 — Serial Communication Controller
0x41302000 FPGAIO size 0x100 — FPGA System Control I/O
0x41303000 UART0 size 0x14
0x41304000 UART1 size 0x14
0x41305000 UART2 size 0x14
0x41306000 UART3 size 0x14
0x41307000 UART4 size 0x14
0x41308000 UART5 size 0x14
0x50000000 TIMER0_Secure size 0x10
0x50001000 TIMER1_Secure size 0x10
0x50002000 DUALTIMER_Secure size 0x3C
0x5002E000 S32KWATCHDOG_Secure size 0xC04
0x50080000 SPCTRL size 0x1000 — Secure Privilege Control Block
0x50081000 WATCHDOG_Secure size 0xC04
0x50083000 SRAM0MPC size 0x1000 — Memory Protection Controller 0
0x50084000 SRAM1MPC size 0x1000 — SRAM 1 Memory Protection Controller
0x50085000 SRAM2MPC size 0x1000 — SRAM 2 Memory Protection Controller
0x50086000 SRAM3MPC size 0x1000 — SRAM 3 Memory Protection Controller
0x51100000 GPIO0_Secure size 0x3C — General-purpose I/O 0 (Secure)
0x51101000 GPIO1_Secure size 0x3C — General-purpose I/O 1 (Secure)
0x51102000 GPIO2_Secure size 0x3C — General-purpose I/O 2 (Secure)
0x51103000 GPIO3_Secure size 0x3C — General-purpose I/O 3 (Secure)
0x51200000 I2C0_Secure size 0xC
0x51201000 I2C1_Secure size 0xC
0x51202000 SSP0_Secure size 0x40 — SPI 0 (Secure)
0x51203000 SSP1_Secure size 0x40 — SPI 1 (Secure)
0x51204000 SSP2_Secure size 0x40 — SPI 2 (Secure)
0x51205000 I2C2_Secure size 0xC
0x51206000 I2C3_Secure size 0xC
0x51208000 I2C4_Secure size 0xC
0x51300000 SCC_Secure size 0x1000 — Serial Communication Controller
0x51302000 FPGAIO_Secure size 0x100 — FPGA System Control I/O (Secure)
0x51303000 UART0_Secure size 0x14
0x51304000 UART1_Secure size 0x14
0x51305000 UART2_Secure size 0x14
0x51306000 UART3_Secure size 0x14
0x51307000 UART4_Secure size 0x14
0x51308000 UART5_Secure size 0x14
0x58007000 SSRAM1MPC size 0x1000 — SSRAM 1 Memory Protection Controller
0x58008000 SSRAM2MPC size 0x1000 — SSRAM 2 Memory Protection Controller
0x58009000 SSRAM3MPC size 0x1000 — SSRAM 3 Memory Protection Controller
0xE000EDD0 SAU size 0x20 — Security Attribution Unit

## Interrupts
1 NONSEC_WATCHDOG_IRQ (WATCHDOG) — Non-Secure Watchdog Interrupt
2 S32KTIMER — Timer 1
3 TIMER0
4 TIMER1
5 DUALTIMER
9 MPC (SRAM0MPC) — MPC Combined
32 UART0_RX (UART0)
34 UART1_RX (UART1)
36 UART2_RX (UART2)
38 UART3_RX (UART3)
40 UART4_RX (UART4)
52 SPI0 (SSP0)
53 SPI1 (SSP1)
54 SPI2 (SSP2)
68 GPIO0 — GPIO 0 combined
69 GPIO1 — GPIO 1 combined
70 GPIO2 — GPIO 2 combined
71 GPIO3 — GPIO 3 combined
124 UART5_RX (UART5)

## Licence text in the file
ARM Limited (ARM) is supplying this software for use with Cortex-M processor based microcontroller, but can be equally used for other suitable processor architectures. This file can be freely distributed. Modifications to this file shall be clearly marked. . THIS SOFTWARE IS PROVIDED "AS IS". NO WARRANTIES, WHETHER EXPRESS, IMPLIED. OR STATUTORY, INCLUDING, BUT NOT LIMITED TO, IMPLIED WARRANTIES OF. MERCHANTABILITY AND FITNESS FOR A PARTICULAR PURPOSE APPLY TO THIS SOFTWARE. ARM SHALL NOT, IN ANY CIRCUMSTANCES, BE LIABLE FOR SPECIAL, INCIDENTAL, OR. CONSEQUENTIAL DAMAGES, FOR ANY REASON WHATSOEVER.

## Notices in the file
Copyright (C) 2012-2018 ARM Limited. All rights reserved.
Purpose: System Viewer Description (SVD) Example (Schema Version 1.1)
This is a description of a none-existent and incomplete device
for demonstration purposes only.
Redistribution and use in source and binary forms, with or without
modification, are permitted provided that the following conditions are met:
- Redistributions of source code must retain the above copyright
notice, this list of conditions and the following disclaimer.
- Redistributions in binary form must reproduce the above copyright
notice, this list of conditions and the following disclaimer in the
documentation and/or other materials provided with the distribution.
- Neither the name of ARM nor the names of its contributors may be used
to endorse or promote products derived from this software without
specific prior written permission.
THIS SOFTWARE IS PROVIDED BY THE COPYRIGHT HOLDERS AND CONTRIBUTORS "AS IS"
AND ANY EXPRESS OR IMPLIED WARRANTIES, INCLUDING, BUT NOT LIMITED TO, THE
ARE DISCLAIMED. IN NO EVENT SHALL COPYRIGHT HOLDERS AND CONTRIBUTORS BE
LIABLE FOR ANY DIRECT, INDIRECT, INCIDENTAL, SPECIAL, EXEMPLARY, OR
CONSEQUENTIAL DAMAGES (INCLUDING, BUT NOT LIMITED TO, PROCUREMENT OF
SUBSTITUTE GOODS OR SERVICES; LOSS OF USE, DATA, OR PROFITS; OR BUSINESS
INTERRUPTION) HOWEVER CAUSED AND ON ANY THEORY OF LIABILITY, WHETHER IN
CONTRACT, STRICT LIABILITY, OR TORT (INCLUDING NEGLIGENCE OR OTHERWISE)
ARISING IN ANY WAY OUT OF THE USE OF THIS SOFTWARE, EVEN IF ADVISED OF THE
POSSIBILITY OF SUCH DAMAGE.
