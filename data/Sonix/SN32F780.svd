# SN32F780 register map
Vendor: SONiX Technology Co., Ltd.; Series: SN32F780; File version: 0.75
ARM 32-bit Cortex-M0 Microcontroller based device, CPU clock up to 72MHz, etc.
CPU: CM0 r0p0, little endian, no MPU, no FPU, 2 interrupt priority bits
Registers are 32-bit, read-write, reset 0x0 unless marked. A register's access mark holds for its fields unless they carry their own. Offsets are from the block's base; lines under a group give offsets from that group; [hi:lo] are bit positions; {n}, {i} and the like mark numbered series; 'fields as' and 'values as' point back to an identical list; <NAME> marks a mode.

## Memory map
0x1FFF2450 SN_UC size 0x2000 — UC Registers
0x40000000 SN_CT16B0 size 0x2000 — 16-bit Timer 0 with Capture function
0x40002000 SN_CT16B1 size 0x2000 — 16-bit Timer 1 with Capture function
0x40004000 SN_CT16B2 size 0x2000 — 16-bit Timer 2 with Capture function
0x40006000 SN_CT16B3 size 0x2000 — 16-bit Timer 3 with Capture function
0x40008000 SN_CT16B4 size 0x2000
0x4000A000 SN_CT16B5 size 0x2000 — 16-bit Timer 5 with Capture function
0x40010000 SN_WDT size 0x2000 — Watchdog Timer
0x40012000 SN_RTC size 0x2000 — Real-time Clock
0x40014000 SN_I2S1 size 0x2000
0x40016000 SN_UART0 size 0x2000 — UART0
0x40018000 SN_I2C0 size 0x2000 — I2C0
0x4001A000 SN_I2S0 size 0x2000 — I2S
0x4001C000 SN_SPI0 size 0x2000 — SPI0
0x40026000 SN_ADC size 0x2000 — ADC
0x40028000 SN_CMP size 0x2000 — Comparator
0x4002A000 SN_OPA size 0x2000 — OP Amplifier
0x40032000 SN_PMU size 0x2000 — Power Management Unit
0x40034000 SN_LCD size 0x2000 — LCD Driver
0x40036000 SN_EBI size 0x2000 — External Bus Interface
0x40038000 SN_CRC size 0x2000 — Cyclic Redundancy Check
0x40042000 SN_PFPA size 0x2000 — Peripheral Function Pin Assignment
0x40044000 SN_GPIO0 size 0x2000
0x40046000 SN_GPIO1 size 0x2000 — General Purpose I/O
0x40048000 SN_GPIO2 size 0x2000 — General Purpose I/O
0x4004A000 SN_GPIO3 size 0x2000
0x40052000 SN_UART3 size 0x2000
0x40054000 SN_UART2 size 0x2000
0x40056000 SN_UART1 size 0x2000
0x40058000 SN_SPI1 size 0x2000 — SPI1
0x4005A000 SN_I2C1 size 0x2000
0x4005E000 SN_SYS1 size 0x2000 — System Control Registers 1
0x40060000 SN_SYS0 size 0x2000 — System Control Registers 0
0x40062000 SN_FLASH size 0x2000 — FLASH Memory Control Registers

## Interrupts
0 NDT (SN_SYS0) — Noise Detection
2 LCD (SN_LCD) — LCD Driver
3 I2S0 (SN_I2S0)
4 I2S1 (SN_I2S1)
5 CMP3 (SN_CMP)
6 SPI0 (SN_SPI0)
7 SPI1 (SN_SPI1)
8 UART2 (SN_UART2)
9 UART3 (SN_UART3)
10 I2C0 (SN_I2C0)
11 I2C1 (SN_I2C1)
12 CMP2 (SN_CMP)
13 UART0 (SN_UART0)
14 UART1 (SN_UART1)
15 CT16B0 (SN_CT16B0) — 16-bit Timer 0
16 CT16B1 (SN_CT16B1)
17 CT16B2 (SN_CT16B2) — 16-bit Timer 2
18 CMP1 (SN_CMP)
19 CT16B3 (SN_CT16B3) — 16-bit Timer 3
20 CT16B4 (SN_CT16B4) — 16-bit Timer 4
21 CT16B5 (SN_CT16B5) — 16-bit Timer 5
22 EBI (SN_EBI) — External Bus Interface
23 RTC (SN_RTC) — Real-time Clock
24 ADC (SN_ADC)
25 WDT (SN_WDT) — Watchdog Timer
26 LVD (SN_SYS0) — Low Voltage Detection
27 CMP0 (SN_CMP)
28 P3 (SN_GPIO3) — GPIO3
29 P2 (SN_GPIO2) — GPIO2
30 P1 (SN_GPIO1) — GPIO1
31 P0 (SN_GPIO0) — GPIO0

## SN_PMU — Power Management Unit
Base 0x40032000
0x40 CTRL — Offset:0x40 PMU Control Register
  [2:0] MODE — Low Power mode selection
    0=Disable; 2=Deep-sleep mode (WFI instruction will make MCU enter Deep-sleep mode); 4=Sleep mode (WFI instruction will make MCU enter Sleep mode)

## Licence text in the file
ARM Limited (ARM) is supplying this software for use with Cortex-M processor based microcontroller, but can be equally used for other suitable processor architectures. This file can be freely distributed. Modifications to this file shall be clearly marked. . THIS SOFTWARE IS PROVIDED "AS IS". NO WARRANTIES, WHETHER EXPRESS, IMPLIED. OR STATUTORY, INCLUDING, BUT NOT LIMITED TO, IMPLIED WARRANTIES OF. MERCHANTABILITY AND FITNESS FOR A PARTICULAR PURPOSE APPLY TO THIS SOFTWARE. ARM SHALL NOT, IN ANY CIRCUMSTANCES, BE LIABLE FOR SPECIAL, INCIDENTAL, OR. CONSEQUENTIAL DAMAGES, FOR ANY REASON WHATSOEVER.

## Notices in the file
Copyright (C) 2019 ARM Limited. All rights reserved.
