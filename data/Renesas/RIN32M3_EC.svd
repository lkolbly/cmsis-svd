# RIN32M3_EC register map
Vendor: Renesas Electronics Corporation; Series: RIN32M3; File version: 0.1
CPU: CM3 r2p1, little endian, MPU, no FPU, 4 interrupt priority bits
Registers are 32-bit, read-write, reset 0x0 unless marked. A register's access mark holds for its fields unless they carry their own. Offsets are from the block's base; [hi:lo] are bit positions; {n}, {i} and the like mark numbered series.

## ECAT — EtherCAT
Base 0x400E0000
0x00 TYPE 8-bit
0x01 REVISION 8-bit ro
0x02 BUILD 16-bit ro
0x04 FMMU_NUM 8-bit ro — FMMUs supported
0x05 SYNC_MANAGER 8-bit ro — SyncManagers supported
0x06 RAM_SIZE 8-bit ro
0x07 PORT_DESC 8-bit ro — Port Descriptor
0x08 FEATURE 16-bit ro — ESC Features supported
0x10 STATION_ADR 16-bit — Configured Station Address
0x12 STATION_ALIAS 16-bit ro — Configured Station Alias
0x20 WR_REG_ENABLE 8-bit — Write Register Enable
0x21 WR_REG_PROTECT 8-bit — Write Register Protection
0x30 ESC_WR_ENABLE 8-bit — ESC Write Enable
0x31 ESC_WR_PROTECT 8-bit — ESC Write Protection
0x40 ESC_RESET_ECAT 8-bit
0x41 ESC_RESET_PDI 8-bit ro
0x100 ESC_DL_CONTROL
0x108 PHYSICAL_RW_OFFSET 16-bit — Physical Read/Write Offset
0x110 ESC_DL_STATUS 16-bit ro
0x120 AL_CONTROL 16-bit reset 0xF
0x130 AL_STATUS 16-bit ro reset 0xF
0x134 AL_STATUS_CODE 16-bit ro
0x138 RUN_LED 8-bit — RUN LED Override
0x139 ERR_LED 8-bit — ERR LED Override
0x140 PDI_CONTROL 8-bit ro
0x141 ESC_CONFIG 8-bit ro — ESC Configuration
0x150 PDI_CONFIG 8-bit ro — PDI Configuration
0x151 SYNC_LATCH_CONFIG 8-bit ro — SYNC/LATCH PDI Configuration
0x152 EXT_PDI_CONFIG 16-bit — 4 Extended PDI Configuration
0x200 ECAT_EVENT_MASK 16-bit
0x204 AL_EVENT_MASK ro reset 0xF (reset mask 0xFFF0000F)
0x210 ECAT_EVENT_REQ 16-bit ro — ECAT Event Request
0x220 AL_EVENT_REQ ro — AL Event Request
{0x300+2i} RX_ERR_COUNT[{i}] (i=0..1) 16-bit — Rx Error Counter [port]
{0x308+i} FWD_RX_ERR_COUNT[{i}] (i=0..1) 8-bit — Forwarded Rx Error counter [port]
0x30C ECAT_PROC_ERR_COUNT 8-bit — ECAT Processing Unit Error Counter
0x30D PDI_ERR_COUNT 8-bit — PDI Error Counter
0x30E PDI_ERR_CODE 8-bit ro — PDI Error Code
{0x310+i} LOST_LINK_COUNT[{i}] (i=0..1) 8-bit — Lost Link Counter [port]
0x400 WD_DIVIDE 16-bit reset 0x9C2 — Watchdog Divider
0x410 WDT_PDI 16-bit reset 0x3E8 — Watchdog Time PDI
0x420 WDT_DATA 16-bit reset 0x3E8 — Watchdog Time Process Data
0x440 WDS_DATA 16-bit ro — Watchdog Status Process Data
0x442 WDC_DATA 8-bit — Watchdog Counter Process Data
0x443 WDC_PDI 8-bit — Watchdog Counter PDI
0x500 EEP_CONF 8-bit — EEPROM Configuration
0x501 EEP_STATE 8-bit ro — EEPROM PDI Access State
0x502 EEP_CONT_STAT 16-bit — EEPROM Control Status
0x504 EEP_ADR — EEPROM Address
0x508 EEP_DATA — EEPROM Data
0x510 MII_CONT_STAT 16-bit — MII Management Control Status
0x512 PHY_ADR 8-bit — PHY Address
0x513 PHY_REG_ADR 8-bit — PHY Register Address
0x514 PHY_DATA 16-bit
0x516 MII_ECAT_ACS_STAT 8-bit — MII Management ECAT Access State
0x517 MII_PDI_ACS_STAT 8-bit — MII Management PDI Access State
{0x518+i} PHY_STATUS[{i}] (i=0..1) 8-bit — PHY Port Status
0x600 L_START_ADR — FMMU Logical Start Address
0x604 FMMU_LEN 16-bit — FMMU Length
0x606 L_START_BIT 8-bit — FMMU Logical Start bit
0x607 L_STOP_BIT 8-bit — FMMU Logical Stop bit
0x608 FMMU_P_START_ADR 16-bit — FMMU Physical Start Address
0x60A P_START_BIT 8-bit — FMMU Physical Start bit
0x60B FMMU_TYPE 8-bit ro reset 0x4
0x60C FMMU_ACT 8-bit — FMMU Activate
0x800 P_START_ADR 16-bit — SM Physical Start Address
0x802 LEN 16-bit — SM Length
0x804 CONTROL 8-bit — SM Control Register
0x805 STATUS 8-bit ro — SM Status Register
0x806 ACT 8-bit — SM Activate
0x807 PDI_CONT 8-bit ro — SM PDI Control
{0x900+4i} DC_RCV_TIME_PORT[{i}] (i=0..3) — Receive Time Port n
0x910 DC_SYS_TIME 64-bit — 4/8 System Time
0x918 DC_RCV_TIME_UNIT 64-bit ro — 4/8 Receive Time ECAT Processing Unit
0x920 DC_SYS_TIME_OFFSET 64-bit — 4/8 System Time Offset
0x928 DC_SYS_TIME_DELAY — System Time Delay
0x92C DC_SYS_TIME_DIFF ro — System Time Difference
0x930 DC_SPEED_COUNT_START 16-bit reset 0x1000 — Speed Counter Start
0x932 DC_SPEED_COUNT_DIFF 16-bit ro — Speed Counter Diff
0x934 DC_SYS_TIME_FIL_DEPTH 8-bit — System Time Difference Filter Depth
0x935 DC_SPEED_COUNT_FIL_DEPTH 8-bit — Speed Counter Filter Depth
0x980 DC_CYC_CONT 8-bit — Cyclic Unit Control
0x981 DC_ACT 8-bit — Activation
0x982 DC_PULSE_LEN 16-bit ro — Pulse Length of SyncSignals
0x984 DC_ACT_STAT 8-bit ro — Activation Status
{0x98E+i} DC_SYNC_STAT[{i}] (i=0..1) 8-bit ro — SYNC n Status
0x990 DC_CYC_START_TIME 64-bit — 4/8 Start Time Cyclic Operation/Next SYNC0 Pulse
0x998 DC_NEXT_SYNC1_PULSE 64-bit ro — 4/8 Next SYNC1 Pulse
{0x9A0+4i} DC_SYNC_CYC_TIME[{i}] (i=0..1) — SYNC n Cycle Time
{0x9A8+i} DC_LATCH_CONT[{i}] (i=0..1) 8-bit — Latch n Control
{0x9AE+i} DC_LATCH_STAT[{i}] (i=0..1) 8-bit ro — Latch n Status
0x9B0 DC_LATCH0_TIME_POS 64-bit ro — 4/8 Latch0 Time Positive Edge
0x9B8 DC_LATCH0_TIME_NEG 64-bit ro — 4/8 Latch0 Time Negative Edge
0x9C0 DC_LATCH1_TIME_POS 64-bit ro — 4/8 Latch1 Time Positive Edge
0x9C8 DC_LATCH1_TIME_NEG 64-bit ro — 4/8 Latch1 Time Negative Edge
0x9F0 DC_ECAT_CNG_EV_TIME ro — EtherCAT Buffer Change Event Time
0x9F8 DC_PDI_START_EV_TIME ro — PDI Buffer Start Event Time
0x9FC DC_PDI_CNG_EV_TIME ro — PDI Buffer Change Event Time
{0xE00+4i} PRODUCT_ID[{i}] (i=0..1) ro
0xE08 VENDOR_ID ro
{0xF10+4i} GPOUT[{i}] (i=0..1) — General Purpose Outputs
{0xF18+4i} GPIN[{i}] (i=0..1) ro — General Purpose Inputs
{0xF80+4i} USER_RAM[{i}] (i=0..31) — User RAM Extended ESC features
{0x1000+4i} DATA_RAM[{i}] (i=0..2047) — Process Data RAM (8K byte)
