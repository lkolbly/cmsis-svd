# RIN32M3_EC register map
Vendor: Renesas Electronics Corporation; Series: RIN32M3; File version: 0.1
Renesas' R-IN32M3 series of large-scale integrated circuits (LSI) are specifically tailored to meet the demands of Industrial Ethernet applications. Key features include: - High-speed, real-time, deterministic, low-latency, low-jitter response for real-time applications - Low power consumption - Integrated ARM Cortex-M3 core for flexibility - Integrated Real-Time OS Accelerator with support for uITRON version 4.0 - Integrated Gigabit Ethernet MAC (R-IN32M3-CL only) - Integrated 10/100Mbps EtherPHY (R-IN32M3-EC only) - Dedicated, DMA controller and buffer for the network processor - High performance with low CPU usage by offloading functions to Real-Time OS Accelerator - Multiple timers, serial interfaces, general purpose I/O (GPIO), external memory interfaces
CPU: CM3 r2p1, little endian, MPU, no FPU, 4 interrupt priority bits
Registers are 32-bit, read-write, reset 0x0 unless marked. A register's access mark holds for its fields unless they carry their own. Offsets are from the block's base; lines under a group give offsets from that group; [hi:lo] are bit positions; {n}, {i} and the like mark numbered series; 'fields as' and 'values as' point back to an identical list; <NAME> marks a mode.

## Memory map
0x40000000 TMR size 0x100 — Timer
0x40000100 CSI0 size 0x100 — CSI
0x40000200 CSI1 size 0x100
0x40000300 UART0 size 0x100 — UART
0x40000400 UART1 size 0x100
0x40000500 IIC0 size 0x100 — IIC
0x40000600 IIC1 size 0x100
0x40000700 WDT size 0x10 — WatchDoc Timer
0x40010000 SYS size 0x10000 — System
0x40020000 CAN0 size 0x20000 — CAN
0x40040000 CAN1 size 0x20000
0x40070000 ETHSW size 0x10000 — Ethernet Switch
0x40080000 HWOS size 0x12000 — Hardware Real Time OS
0x40090000 ETH size 0x1000 — Ethernet MAC
0x400A2000 MEMC size 0x400 — Memory controller (ROM/SRAM)
0x400A2400 SROM size 0x100 — Serial flash ROM memory controller
0x400A2800 DMAC0 size 0x40 — DMA controller
0x400A2840 DMAC1 size 0x40
0x400A2880 DMAC2 size 0x40
0x400A28C0 DMAC3 size 0x40
0x400A2C00 RTDMAC size 0x40
0x400A3000 GPIO size 0x400 — Port (GPIO)
0x400A3400 RTPORT size 0x400 — Port (RTPORT)
0x400A4400 CC_Link_BR size 0x400 — CC-Link Bus Bridge Control
0x400A8000 SMC size 0x200 — Burst memory controler
0x400E0000 ECAT size 0x10000 — EtherCAT
0x400F8000 CCS size 0x4000 — CC-Link Remote Device Station

## Interrupts
0 TAUJ2I0 (TMR)
1 TAUJ2I1 (TMR)
2 TAUJ2I2 (TMR)
3 TAUJ2I3 (TMR)
4 UAJ0TIT (UART0)
5 UAJ0TIR (UART0)
6 UAJ1TIT (UART1)
7 UAJ1TIR (UART1)
8 CSIH0IC (CSI0)
9 CSIH0IR (CSI0)
10 CSIH0IJC (CSI0)
11 CSIH1IC (CSI1)
12 CSIH1IR (CSI1)
13 CSIH1IJC (CSI1)
14 IICB0TIA (IIC0)
15 IICB1TIA (IIC1)
16 FCN0REC (CAN0)
17 FCN0TRX (CAN0)
18 FCN0WUP (CAN0)
19 FCN1REC (CAN1)
20 FCN1TRX (CAN1)
21 FCN1WUP (CAN1)
22 DMA00 (DMAC0)
23 DMA01 (DMAC1)
24 DMA02 (DMAC2)
25 DMA03 (DMAC3)
26 RTDMA (RTDMAC)
27 CATSYNC0 (ECAT)
28 CATSYNC1 (ECAT)
29 CAT (ECAT)
30 CATSOF (ECAT)
31 CATEOF (ECAT)
32 BUFDMA (HWOS)
33 PHY0 (ETH)
34 PHY1 (ETH)
35 ETHMII (ETH)
36 ETHPAUSE (ETH)
37 ETHTX (ETH)
38 ETHSW
39 ETHSWDLR (ETHSW)
40 ETHSWSEC (ETHSW)
41 ETHRXFIFO (ETH)
42 ETHTXFIFO (ETH)
43 ETHRXDMA (ETH)
44 ETHTXDMA (ETH)
45 MACDMARXFRM (ETH)
46 HOSTIF (SYS)
{n+47} INTPZ{n} (GPIO) (n=0..28)
76 HWRTOS (HWOS)
77 BRAMERR (HWOS)
78 IICB0TIS (IIC0)
79 IICB1TIS (IIC1)
80 WDTA0 (WDT)
81 SFLASH (SROM)
82 UAJ0TIS (UART0)
83 UAJ1TIS (UART1)
84 CSIH0IRE (CSI0)
85 CSIH1IRE (CSI1)
86 FCN0ERR (CAN0)
87 FCN1ERR (CAN1)
88 DERR0 (DMAC0)
89 DERR1 (RTDMAC)
90 ETHTXFIFOERR (ETH)
91 ETHRXERR (ETH)
92 ETHRXDERR (ETH)
93 ETHTXDERR (ETH)
94 BUFDMAERR (ETH)
95 ECATWDT (ECAT)
96 ECATRST (ECAT)
115 CCMRQ (CCS)
116 CCSRFSTB (CCS)
117 CCSMON3 (CCS)

## TMR — Timer
Base 0x40000000
{0x0+4i} TAUJ2CDR{i} (i=0..3) — channel data register {i}
{0x10+4i} TAUJ2CNT{i} (i=0..3) — channel counter register {i}
{0x20+4i} TAUJ2CMUR{i} 8-bit (i=0..3) — channel mode user register {i}
{0x30+4i} TAUJ2CSR{i} 8-bit ro (i=0..3) — channel status register {i}
{0x40+4i} TAUJ2CSC{i} 8-bit wo (i=0..3) — channel status clear trigger register {i}
0x50 TAUJ2TE 8-bit ro — channel enable status register
0x54 TAUJ2TS 8-bit wo — channel start trigger register
0x58 TAUJ2TT 8-bit wo — channel stop trigger register
0x5C TAUJ2TO 8-bit — channel output register
0x60 TAUJ2TOE 8-bit — channel output enable register
0x64 TAUJ2TOL 8-bit — channel output active level register
0x68 TAUJ2RDT 8-bit wo — channel reload data trigger register
0x6C TAUJ2RSF 8-bit ro — channel reload status register
{0x80+4i} TAUJ2CMOR{i} 16-bit (i=0..3) — channel mode OS register {i}
0x90 TAUJ2TPS 16-bit reset 0xFFFF — prescaler clock select register
0x94 TAUJ2BRS 8-bit — prescaler baud rate setting register
0x98 TAUJ2TOM 8-bit — channel output mode register
0x9C TAUJ2TOC 8-bit — channel output configuration register
0xA0 TAUJ2RDE 8-bit — channel reload data enable register
0xA4 TAUJ2RDM 8-bit — channel reload data mode register

## Licence text in the file
Copyright (C) 2011-2013 Renesas Electronics Corporation. Copyright (C) 2011-2013 Renesas Micro Systems Co., Ltd. . This is a sample program. Renesas Electronics assumes no responsibility for any losses incurred.

## Notices in the file
Copyright (C) 2012 ARM Limited. All rights reserved.
