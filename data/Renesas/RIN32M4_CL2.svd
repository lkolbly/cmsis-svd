# RIN32M4_CL2 register map
Vendor: Renesas Electronics Corporation; Series: RIN32M4; File version: 0.1
CPU: CM4 r0p1, little endian, MPU, FPU, 4 interrupt priority bits
Registers are 32-bit, read-write, reset 0x0 unless marked. A register's access mark holds for its fields unless they carry their own. Offsets are from the block's base; [hi:lo] are bit positions; {n}, {i} and the like mark numbered series.

## TAUJ2 — Timer array unit(TAUJ2)
Base 0x40000000
{0x0+4i} TAUJ2CDR{i} (i=0..3) — channel data register m
{0x10+4i} TAUJ2CNT{i} (i=0..3) ro — channel counter register m
{0x20+4i} TAUJ2CMUR{i} (i=0..3) 8-bit — channel mode user register m
{0x30+4i} TAUJ2CSR{i} (i=0..3) 8-bit ro — channel status register m
{0x40+4i} TAUJ2CSC{i} (i=0..3) 8-bit wo — channel status clear trigger register m
0x50 TAUJ2TE 8-bit ro — channel enable status register
0x54 TAUJ2TS 8-bit wo — channel start trigger register
0x58 TAUJ2TT 8-bit wo — channel stop trigger register
0x5C TAUJ2TO 8-bit — channel output register
0x60 TAUJ2TOE 8-bit — channel output enable register
0x64 TAUJ2TOL 8-bit — channel output active level register
0x68 TAUJ2RDT 8-bit wo — channel reload data trigger register
0x6C TAUJ2RSF 8-bit ro — channel reload status register
{0x80+4i} TAUJ2CMOR{i} (i=0..3) 16-bit — channel mode OS register m
0x90 TAUJ2TPS 16-bit reset 0xFFFF — prescaler clock select register
0x94 TAUJ2BRS 8-bit — prescaler baud rate setting register
0x98 TAUJ2TOM 8-bit — channel output mode register
0x9C TAUJ2TOC 8-bit — channel output configuration register
0xA0 TAUJ2RDE 8-bit — channel reload data enable register
0xA4 TAUJ2RDM 8-bit — channel reload data mode register

## CSI0 — CSI
Base 0x40000100
Same registers: CSI1 0x40000200
0x00 CSIHnCTL0 — Control register 0
0x04 CSIHnSTR0 ro reset 0x10 — Status register 0
0x08 CSIHnSTCR0 wo — Status clear register 0
0x10 CSIHnCTL1 — Control register 1
0x14 CSIHnCTL2 reset 0xE000 — Control register 2
0x80 CSIHnMCTL1 — Memory control register 1
0x84 CSIHnMCTL2 — Memory control register 2
0x88 CSIHnTX0W — Transmit data register 0 for word access
0x8C CSIHnTX0H — Transmit data register 0 for half word access
0x90 CSIHnRX0W ro — Receive data register 0 for word access
0x94 CSIHnRX0H ro — Receive data register 0 for half word access
0x98 CSIHnMRWP0 — Memory read/write pointerregister 0
0xC0 CSIHnMCTL0 reset 0x1F — Memory control register 0
0xC4 CSIHnCFG0 — Configuration register 0
0xC8 CSIHnCFG1 — Configuration register 1

## UART0 — UART
Base 0x40000300
Same registers: UART1 0x40000400
0x00 URTJnCTL0 — Control Register 0
0x04 URTJnTRG — Triger Register
0x08 URTJnSTR0 ro — Status Register 0
0x0C URTJnSTR1 ro — Status Register 1
0x10 URTJnSTC — Status Clear Register
0x20 URTJnCTL1 reset 0x5002 — Control Register 1
0x24 URTJnCTL2 reset 0xEFFF — Control Register 2
0x80 URTJnFCTL0 reset 0xF00 — FIFO Control Register 0
0x84 URTJnFSTR0 ro reset 0x10 — FIFO Status Register 0
0x88 URTJnFSTR1 ro reset 0x5 — FIFO Status Register 1
0x8C URTJnFSTC — FIFO Status Clear Register
0x90 URTJnFRX ro reset 0xFF — FIFO Recieve Data Register
0x94 URTJnFTX 8-bit reset 0xFF — FIFO Transmit Data Register
0xA0 URTJnFCTL1 reset 0x3F — FIFO Control Register 1

## IIC0 — IIC
Base 0x40000500
Same registers: IIC1 0x40000600
0x00 IICBnDAT 8-bit — Data register
0x04 IICBnSVA 8-bit — Slave address register
0x08 IICBnCTL0 8-bit — Control Register 0
0x0C IICBnTRG 8-bit — Trigger register
0x10 IICBnSTR0 16-bit ro — Status Register 0
0x14 IICBnSTR1 8-bit ro — Status Register 1
0x18 IICBnSTRC 8-bit — Status clear register
0x20 IICBnCTL1 8-bit — Control Register 1
0x24 IICBnWL 16-bit reset 0x3FF — Low level width setting register
0x28 IICBnWH 16-bit reset 0x3FF — High level width setting register

## WDT — Watchdog Timer
Base 0x40000700
0x00 WDTA0WDTE 8-bit reset 0x2C — Watchdog Timer Enable register
0x0C WDTA0MD 8-bit reset 0xF — Watchdog Timer Mode register

## TAUD — Timer Array Unit D
Base 0x40000800
{0x0+4i} TAUDCDR{i} (i=0..15) 16-bit — Channel Data Register m
0x40 TAUDTOL 16-bit — Channel Output Active Level Register
0x44 TAUDRDT 16-bit wo — Channel Reload data Trigger Register
0x48 TAUDRSF 16-bit ro — Channel Reload Status Register
0x4C TAUDTRO 16-bit — Channel Real Time Output Register
0x50 TAUDTME 16-bit — Channel Modulation Output Authorized Register
0x54 TAUDTDL 16-bit — Channel Dead Time Output Level Register
0x58 TAUDTO 16-bit — Channel Output Register
0x5C TAUDTOE 16-bit — Channel Output Authorized Register
{0x80+4i} TAUDCNT{i} (i=0..15) 16-bit ro reset 0xFFFF — Channel Counter Register m
{0xC0+4i} TAUDCMUR{i} (i=0..15) 8-bit — Channel Mode User Register m
{0x140+4i} TAUDCSR{i} (i=0..15) 8-bit ro — Channel Status Register m
{0x180+4i} TAUDCSC{i} (i=0..15) 8-bit wo — Channel Status Clear Trigger Register m
0x1C0 TAUDTE 16-bit ro — Channel Authorized Status Register
0x1C4 TAUDTS 16-bit wo — Channel Start Trigger Register
0x1C8 TAUDTT 16-bit wo — Channel Stop Trigger Register
{0x200+4i} TAUDCMOR{i} (i=0..15) 16-bit — Channel Mode OS Register m
0x240 TAUDTPS 16-bit reset 0xFFFF — Prescaler Clock Selected Register
0x244 TAUDBRS 8-bit — Prescaler Baudrate setting Register
0x248 TAUDTOM 16-bit — Channel Output Mode Register
0x24C TAUDTOC 16-bit — Channel Output Configuration Register
0x250 TAUDTDE 16-bit — Channel Dead Time Output Authorized Register
0x254 TAUDTDM 16-bit — Channel Dead Time Output Mode Register
0x258 TAUDTRE 16-bit — Channel Real Time Output Authorized Register
0x25C TAUDTRC 16-bit — Channel Real Time Output Control Register
0x260 TAUDRDE 16-bit — Channel Reload data Authorized Register
0x264 TAUDRDM 16-bit — Channel Reload data Mode Register
0x268 TAUDRDS 16-bit — Channel Reload data Control CH Selected Register
0x26C TAUDRDC 16-bit — Channel Reload data Control Register
0x290 TAUDEMU 8-bit — Emulation Register
