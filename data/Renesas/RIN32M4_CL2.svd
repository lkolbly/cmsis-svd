# RIN32M4_CL2 register map
Vendor: Renesas Electronics Corporation; Series: RIN32M4; File version: 0.1
CPU: CM4 r0p1, little endian, MPU, FPU, 4 interrupt priority bits
Registers are 32-bit, read-write, reset 0x0 unless marked. A register's access mark holds for its fields unless they carry their own. Offsets are from the block's base; [hi:lo] are bit positions; {n}, {i} and the like mark numbered series.

## HWOS — Hardware Real Time OS
Base 0x40080000
0xF000 SYSC — CPU I/F SYSC
{0xEFF4+4i} R{i}_ (i=4..7) — CPU I/F R{i}
0xF014 CMD — CPU I/F R7
0xF020 R0_ — CPU I/F R0
0xF024 R1_ — CPU I/F R1

## ETH — Ethernet MAC
Base 0x40090000
0x0C GMAC_TXID ro — TXID
0x10 GMAC_TXRESULT ro — TX Result
0x20 GMAC_MODE — MODE
0x24 GMAC_RXMODE reset 0x20000000 — RX MODE
0x28 GMAC_TXMODE — TX MODE
0x30 GMAC_RESET wo — RESET
{0x7C+4i} GMAC_PAUSE{i} (i=1..5) — Pause Packet {i}
0x98 GMAC_FLWCTL — RX Flow Control
0x9C GMAC_PAUSPKT — Pause PKT
0xA0 GMAC_MIIM reset 0x4000000 — MIIM
{0x100+8i} GMAC_ADR{i}A (i=0..15) — MAC Address {i}A
{0x104+8i} GMAC_ADR{i}B reset 0xFF0000 (i=0..15) — MAC Address {i}B
0x200 GMAC_RXFIFO ro reset 0x40000000 — RX FIFO
0x204 GMAC_TXFIFO ro reset 0x60000000 — TX FIFO
0x208 GMAC_ACC reset 0x3 — TCPIP Acc
0x220 GMAC_RXMAC_ENA reset 0x1 — RXMAC Enable
0x224 GMAC_LPI_MODE — LPI Mode
0x228 GMAC_LPI_TIMING reset 0x80F — LPI Timing

## QINT_BUFID — Receive Buffer Information
Base 0x40091000
0x100 BUFID

## MEMC — Memory controller (ROM/SRAM)
Base 0x400A2000
0x04 BSC reset 0x5555 — Bus Size Control register
{0x8+4i} SMC{i} reset 0xFFFF (i=0..3) — Static Memory Control register {i}
0x18 PRC reset 0xF0000000 — Page Rom Control register

## SROM — Serial flash ROM memory controller
Base 0x400A2400
0x00 SFMSMD reset 0x110 — Transfer mode control register
0x04 SFMSSC reset 0x37 — Chip select control register
0x08 SFMSKC reset 0x8 — Clock control register
0x0C SFMSST ro reset 0x80 — Status register
0x10 SFMCOM — Communication port register
0x14 SFMCMD — Communication mode control register
0x18 SFMCST — Communication status register
0x20 SFMSIC — Command code register
0x24 SFMSAC reset 0x2 — Address mode control register
0x28 SFMSDC reset 0xFF00 — Dummy Cycle control register
0x30 SFMSPC reset 0x10 — SPI Protocol control register
0x34 SFMPMD — Port mode control register
0x38 SFMDTC — Data Input Timing register
0x4C SFMVER reset 0x300 — Version register

## DMAC0 — DMA controller
Base 0x400A2800
Same registers: DMAC1 0x400A2840, DMAC2 0x400A2880, DMAC3 0x400A28C0, RTDMAC 0x400A2C00
0x00 N0SAn — Source address register [Next0]
0x04 N0DAn — Destination address register [Next0]
0x08 N0TBn — Transaction byte register [Next0]
0x0C N1SAn — Source address register [Next1]
0x10 N1DAn — Destination address register [Next1]
0x14 N1TBn — Transaction byte register [Next1]
0x18 CRSAn ro — Source address register [Current]
0x1C CRDAn ro — Destination address register [Current]
0x20 CRTBn ro — Transaction byte register [Current]
0x24 CHSTATn ro — Channel status register
0x28 CHCTRLn wo — Channel control register
0x2C CHCFGn — Channel configulation register
0x30 CHITVLn — Channel intereval register
0x38 NXLAn — Link address register [Next]
0x3C CRLAn ro — Link address register [Current]

## DSS0 — DMAC space source size
Base 0x400A2A00
Same registers: DSS1 0x400A2A20, DSS2 0x400A2A40, DSS3 0x400A2A60, RTDSS 0x400A2E00
0x00 SCNTn — Continuous space source size register
0x04 SSKPn — Skip space source size register
0x08 DCNTn — Continuous space destination size register
0x0C DSKPn — Skip space destination size register

## DCTL — DMA control
Base 0x400A2B00
Same registers: RTDCTL 0x400A2F00
0x00 DCTRL — DMAC control register
0x04 DSCITVL — DMAC descriptor interval register
0x10 DSTEN ro — DMAC enable status register
0x14 DSTER ro — DMAC error status register
0x18 DSTEND ro — DMAC end status register
0x1C DSTTC ro — DMAC terminal count status register
0x20 DSTSUS ro — DMAC suspend status register
