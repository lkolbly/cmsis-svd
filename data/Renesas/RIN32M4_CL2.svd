# RIN32M4_CL2 register map
Vendor: Renesas Electronics Corporation; Series: RIN32M4; File version: 0.1
CPU: CM4 r0p1, little endian, MPU, FPU, 4 interrupt priority bits
Registers are 32-bit, read-write, reset 0x0 unless marked. A register's access mark holds for its fields unless they carry their own. Offsets are from the block's base; [hi:lo] are bit positions; {n}, {i} and the like mark numbered series.

## GPIO — Port (GPIO)
Base 0x400A3000
0x00 P0W (reset mask 0xFF) — Port register 0 ( 32 bit)
0x00 P0H 16-bit (reset mask 0xFF) (alternate view of P0W) — Port register 0 ( 16 bit)
{0x0+i} P{i}B 8-bit (alternate view of P0W) (i=0..3) — Port register {i} ( 8 bit)
0x02 P2H 16-bit (reset mask 0xFF) (alternate view of P0W) — Port register 2 ( 16 bit)
0x04 P4W (reset mask 0xFF) — Port register 4 ( 32 bit)
0x04 P4H 16-bit (reset mask 0xFF) (alternate view of P4W) — Port register 4 ( 16 bit)
{0x0+i} P{i}B 8-bit (alternate view of P4W) (i=4..7) — Port register {i} ( 8 bit)
0x06 P6H 16-bit (reset mask 0xFF) (alternate view of P4W) — Port register 6 ( 16 bit)
0x10 PM0W reset 0xFF (reset mask 0xFF) — Port mode register 0 ( 32 bit)
0x10 PM0H 16-bit reset 0xFF (reset mask 0xFF) (alternate view of PM0W) — Port mode register 0 ( 16 bit)
{0x10+i} PM{i}B 8-bit reset 0xFF (alternate view of PM0W) (i=0..3) — Port mode register {i} ( 8 bit)
0x12 PM2H 16-bit reset 0xFF (reset mask 0xFF) (alternate view of PM0W) — Port mode register 2 ( 16 bit)
0x14 PM4W reset 0xFF (reset mask 0xFF) — Port mode register 4 ( 32 bit)
0x14 PM4H 16-bit reset 0xFF (reset mask 0xFF) (alternate view of PM4W) — Port mode register 4 ( 16 bit)
{0x10+i} PM{i}B 8-bit reset 0xFF (alternate view of PM4W) (i=4..7) — Port mode register {i} ( 8 bit)
0x16 PM6H 16-bit reset 0xFF (reset mask 0xFF) (alternate view of PM4W) — Port mode register 6 ( 16 bit)
0x20 PMC0W (reset mask 0xFF) — Port mode control register 0 ( 32 bit)
0x20 PMC0H 16-bit (reset mask 0xFF) (alternate view of PMC0W) — Port mode control register 0 ( 16 bit)
{0x20+i} PMC{i}B 8-bit (alternate view of PMC0W) (i=0..3) — Port mode control register {i} ( 8 bit)
0x22 PMC2H 16-bit (reset mask 0xFF) (alternate view of PMC0W) — Port mode control register 2 ( 16 bit)
0x24 PMC4W (reset mask 0xFF) — Port mode control register 4 ( 32 bit)
0x24 PMC4H 16-bit (reset mask 0xFF) (alternate view of PMC4W) — Port mode control register 4 ( 16 bit)
{0x20+i} PMC{i}B 8-bit (alternate view of PMC4W) (i=4..7) — Port mode control register {i} ( 8 bit)
0x26 PMC6H 16-bit (reset mask 0xFF) (alternate view of PMC4W) — Port mode control register 6 ( 16 bit)
0x30 PFC0W (reset mask 0xFF) — Port function control register 0 ( 32 bit)
0x30 PFC0H 16-bit (reset mask 0xFF) (alternate view of PFC0W) — Port function control register 0 ( 16 bit)
{0x30+i} PFC{i}B 8-bit (alternate view of PFC0W) (i=0..3) — Port function control register {i} ( 8 bit)
0x32 PFC2H 16-bit (reset mask 0xFF) (alternate view of PFC0W) — Port function control register 2 ( 16 bit)
0x34 PFC4W (reset mask 0xFF) — Port function control register 4 ( 32 bit)
0x34 PFC4H 16-bit (reset mask 0xFF) (alternate view of PFC4W) — Port function control register 4 ( 16 bit)
{0x30+i} PFC{i}B 8-bit (alternate view of PFC4W) (i=4..7) — Port function control register {i} ( 8 bit)
0x36 PFC6H 16-bit (reset mask 0xFF) (alternate view of PFC4W) — Port function control register 6 ( 16 bit)
0x40 PFCE0W (reset mask 0xFF) — Port function control ext.register 0 ( 32 bit)
0x40 PFCE0H 16-bit (reset mask 0xFF) (alternate view of PFCE0W) — Port function control ext.register 0 ( 16 bit)
{0x40+i} PFCE{i}B 8-bit (alternate view of PFCE0W) (i=0..3) — Port function control ext.register {i} ( 8 bit)
0x42 PFCE2H 16-bit (reset mask 0xFF) (alternate view of PFCE0W) — Port function control ext.register 2 ( 16 bit)
0x44 PFCE4W (reset mask 0xFF) — Port function control ext.register 4 ( 32 bit)
0x44 PFCE4H 16-bit (reset mask 0xFF) (alternate view of PFCE4W) — Port function control ext.register 4 ( 16 bit)
{0x40+i} PFCE{i}B 8-bit (alternate view of PFCE4W) (i=4..7) — Port function control ext.register {i} ( 8 bit)
0x46 PFCE6H 16-bit (reset mask 0xFF) (alternate view of PFCE4W) — Port function control ext.register 6 ( 16 bit)
0x50 PIN0W ro (reset mask 0xFF) — Port input level register 0 ( 32 bit)
0x50 PIN0H 16-bit ro (reset mask 0xFF) (alternate view of PIN0W) — Port input level register 0 ( 16 bit)
{0x50+i} PIN{i}B 8-bit ro (alternate view of PIN0W) (i=0..3) — Port input level register {i} ( 8 bit)
0x52 PIN2H 16-bit ro (reset mask 0xFF) (alternate view of PIN0W) — Port input level register 2 ( 16 bit)
0x54 PIN4W ro (reset mask 0xFF) — Port input level register 4 ( 32 bit)
0x54 PIN4H 16-bit ro (reset mask 0xFF) (alternate view of PIN4W) — Port input level register 4 ( 16 bit)
{0x50+i} PIN{i}B 8-bit ro (alternate view of PIN4W) (i=4..7) — Port input level register {i} ( 8 bit)
0x56 PIN6H 16-bit ro (reset mask 0xFF) (alternate view of PIN4W) — Port input level register 6 ( 16 bit)
