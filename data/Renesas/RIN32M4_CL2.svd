# RIN32M4_CL2 register map
Vendor: Renesas Electronics Corporation; Series: RIN32M4; File version: 0.1
CPU: CM4 r0p1, little endian, MPU, FPU, 4 interrupt priority bits
Registers are 32-bit, read-write, reset 0x0 unless marked. A register's access mark holds for its fields unless they carry their own. Offsets are from the block's base; [hi:lo] are bit positions; {n}, {i} and the like mark numbered series.

## RTPORT — Port (RTPORT)
Base 0x400A3400
0x00 RP0W (reset mask 0xFF) — RT Port register 0 ( 32 bit)
0x00 RP0H 16-bit (reset mask 0xFF) (alternate view of RP0W) — RT Port register 0 ( 16 bit)
{0x0+i} RP{i}B 8-bit (alternate view of RP0W) (i=0..3) — RT Port register {i} ( 8 bit)
0x02 RP2H 16-bit (reset mask 0xFF) (alternate view of RP0W) — RT Port register 2 ( 16 bit)
0x10 RPM0W reset 0xFF (reset mask 0xFF) — RT Port mode register 0 ( 32 bit)
0x10 RPM0H 16-bit (reset mask 0xFF) (alternate view of RPM0W) — RT Port mode register 0 ( 16 bit)
{0x10+i} RPM{i}B 8-bit reset 0xFF (alternate view of RPM0W) (i=0..3) — RT Port mode register {i} ( 8 bit)
0x12 RPM2H 16-bit reset 0xFF (reset mask 0xFF) (alternate view of RPM0W) — RT Port mode register 2 ( 16 bit)
0x20 RPMC0W (reset mask 0xFF) — RT Port mode control register 0 ( 32 bit)
0x20 RPMC0H 16-bit (reset mask 0xFF) (alternate view of RPMC0W) — RT Port mode control register 0 ( 16 bit)
{0x20+i} RPMC{i}B 8-bit (alternate view of RPMC0W) (i=0..3) — RT Port mode control register {i} ( 8 bit)
0x22 RPMC2H 16-bit (reset mask 0xFF) (alternate view of RPMC0W) — RT Port mode control register 2 ( 16 bit)
0x30 RPFC0W (reset mask 0xFF) — RT Port function control register 0 ( 32 bit)
0x30 RPFC0H 16-bit (reset mask 0xFF) (alternate view of RPFC0W) — RT Port function control register 0 ( 16 bit)
{0x30+i} RPFC{i}B 8-bit (alternate view of RPFC0W) (i=0..3) — RT Port function control register {i} ( 8 bit)
0x32 RPFC2H 16-bit (reset mask 0xFF) (alternate view of RPFC0W) — RT Port function control register 2 ( 16 bit)
0x40 RPFCE0W (reset mask 0xFF) — RT Port function control ext.register 0 ( 32 bit)
0x40 RPFCE0H 16-bit (reset mask 0xFF) (alternate view of RPFCE0W) — RT Port function control ext.register 0 ( 16 bit)
{0x40+i} RPFCE{i}B 8-bit (alternate view of RPFCE0W) (i=0..3) — RT Port function control ext.register {i} ( 8 bit)
0x42 RPFCE2H 16-bit (reset mask 0xFF) (alternate view of RPFCE0W) — RT Port function control ext.register 2 ( 16 bit)
0x50 RPIN0W ro (reset mask 0xFF) — RT Port input level register 0 ( 32 bit)
0x50 RPIN0H 16-bit ro (reset mask 0xFF) (alternate view of RPIN0W) — RT Port input level register 0 ( 16 bit)
{0x50+i} RPIN{i}B 8-bit ro (alternate view of RPIN0W) (i=0..3) — RT Port input level register {i} ( 8 bit)
0x52 RPIN2H 16-bit ro (reset mask 0xFF) (alternate view of RPIN0W) — RT Port input level register 2 ( 16 bit)

## EXTPORT — Port (EXTPORT)
Base 0x400A3800
0x00 EXTP0W (reset mask 0xFF) — EXT Port register 0 ( 32 bit)
0x00 EXTP0H 16-bit (reset mask 0xFF) (alternate view of EXTP0W) — EXT Port register 0 ( 16 bit)
0x00 EXTP0B 8-bit (alternate view of EXTP0W) — EXT Port register 0 ( 8 bit)
0x01 EXTP1B 8-bit (alternate view of EXTP0W) — EXT Port register 1 ( 8 bit)
0x10 EXTPM0W reset 0xFF (reset mask 0xFF) — EXT Port mode register 0 ( 32 bit)
0x10 EXTPM0H 16-bit reset 0xFF (reset mask 0xFF) (alternate view of EXTPM0W) — EXT Port mode register 0 ( 16 bit)
0x10 EXTPM0B 8-bit reset 0xFF (alternate view of EXTPM0W) — EXT Port Mode register 0 ( 8 bit)
0x11 EXTPM1B 8-bit reset 0xFF (alternate view of EXTPM0W) — EXT Port Mode register 1 ( 8 bit)
0x20 EXTPMC0W (reset mask 0xFF) — EXT Port mode control register 0 ( 32 bit)
0x20 EXTPMC0H 16-bit (reset mask 0xFF) (alternate view of EXTPMC0W) — EXT Port mode control register 0 ( 16 bit)
0x20 EXTPMC0B 8-bit (alternate view of EXTPMC0W) — EXT Port mode control register 0 ( 8 bit)
0x21 EXTPMC1B 8-bit (alternate view of EXTPMC0W) — EXT Port mode control register 1 ( 8 bit)
0x30 EXTPFC0W (reset mask 0xFF) — EXT Port function control register 0 ( 32 bit)
0x30 EXTPFC0H 16-bit (reset mask 0xFF) (alternate view of EXTPFC0W) — EXT Port function control register 0 ( 16 bit)
0x30 EXTPFC0B 8-bit (alternate view of EXTPFC0W) — EXT function control register 0 ( 8 bit)
0x31 EXTPFC1B 8-bit (alternate view of EXTPFC0W) — EXT function control register 1 ( 8 bit)
0x40 EXTPFCE0W (reset mask 0xFF) — EXT Port function control ext.register 0 ( 32 bit)
0x40 EXTPFCE0H 16-bit (reset mask 0xFF) (alternate view of EXTPFCE0W) — EXT Port function control ext.register 0 ( 16 bit)
0x40 EXTPFCE0B 8-bit (alternate view of EXTPFCE0W) — EXT function control expregister 0 ( 8 bit)
0x41 EXTPFCE1B 8-bit (alternate view of EXTPFCE0W) — EXT function control expregister 1 ( 8 bit)
0x50 EXTPIN0W ro (reset mask 0xFF) — EXT Port input register 0 ( 32 bit)
0x50 EXTPIN0H 16-bit ro (reset mask 0xFF) (alternate view of EXTPIN0W) — EXT Port input register 0 ( 16 bit)
0x50 EXTPIN0B 8-bit ro (alternate view of EXTPIN0W) — EXT Port input register 0 ( 8 bit)
0x51 EXTPIN1B 8-bit ro (alternate view of EXTPIN0W) — EXT Port input register 0 ( 8 bit)

## SMC — Burst memory controller
Base 0x400A8000
0x10 DIRECT_CMD wo — Direct Command Register
0x14 SET_CYCLES wo
0x18 SET_OPMODE wo — Set Operating Mode Register
0x20 REF_PERIOD0 — Refresh Period 0 Register
{0x100+0x20*i} SRAM_CYCLES0_{i} ro reset 0x2B3CC (i=0..3) — CS{i} cycle setting register
{0x104+0x20*i} OPMODE0_{i} ro (i=0..3) — CS{i} mode register

## CC_Link_IEF_BR — CC-Link IE Field BUS Control
Base 0x400A4000
0x04 CIEBSC reset 0xFFFF — CC-Link IE Bus Size Control register
0x08 CIESMC reset 0xFFFF — CC-Link IE BUS Bridge Control register

## CC_Link_BR — CC-Link BUS Control
Base 0x400A4400
0x04 CCBSC reset 0x5555 — Bus Size Control register
0x08 CCSMC0 reset 0xFFFF — CC-Link BUS Control register 0
0x0C CCSMC1 reset 0xFFFF — CC-Link BUS Control register 1

## CC_Link_RMT — CC-Link Remote Device Station
Base 0x400FB000
0x00 CCS_MWRENL_RCEX 16-bit ro — Send data write enable information register
0x02 CCS_M3STNO_BSW_KYOKU 16-bit ro — Station number and Baud rate switch information register
0x04 CCS_M3ERR1_ERR2 16-bit ro — Error information register
0x08 CCS_M3MRST1_ST2 16-bit ro — M-R status information register
{0xA+2i} CCS_M3MRRY{10i:02}_{i}F 16-bit ro (i=0..7) — M-R RY{10i:02}-{i}F register
{0x1A+2i} CCS_M3MRRWW{i} 16-bit ro (i=0..15) — M-R RWw{i} register
0x80 CCS_M3SDOK_RDRQ 16-bit — Send data write complete flag and Receive data read request register
0x82 CCS_M3VENDORCODE 16-bit — Vendor code register
0x84 CCS_M3MODELCODE_VERSION 16-bit — Model code and version register
0x86 CCS_M3SDLED_TOVER 16-bit — SDLED illumination time setting and Timeout time setting register
0x88 CCS_M3RMST1_ST2 16-bit — Cyclic Communication register
{0x8A+2i} CCS_M3RMRX{10i:02}_{i}F 16-bit (i=0..7) — R-M RX{10i:02}-{i}F register
{0x9A+2i} CCS_M3RMRWR{i} 16-bit (i=0..15) — M-R RWr{i} register
0xBA CCS_M3HOLDCLR 16-bit — HOLD/CLR Information Setting register
