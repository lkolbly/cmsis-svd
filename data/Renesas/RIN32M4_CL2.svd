# RIN32M4_CL2 register map
Vendor: Renesas Electronics Corporation; Series: RIN32M4; File version: 0.1
ARM 32-bit Cortex-M4F Microcontroller based device, CPU clock up to 100MHz, etc.
CPU: CM4 r0p1, little endian, MPU, FPU, 4 interrupt priority bits
Registers are 32-bit, read-write, reset 0x0 unless marked. A register's access mark holds for its fields unless they carry their own. Offsets are from the block's base; lines under a group give offsets from that group; [hi:lo] are bit positions; {n}, {i} and the like mark numbered series; 'fields as' and 'values as' point back to an identical list; <NAME> marks a mode.

## Memory map
0x40000000 TAUJ2 size 0x100 — Timer array unit(TAUJ2)
0x40000100 CSI0 size 0x100 — CSI
0x40000200 CSI1 size 0x100
0x40000300 UART0 size 0x100 — UART
0x40000400 UART1 size 0x100
0x40000500 IIC0 size 0x100 — IIC
0x40000600 IIC1 size 0x100
0x40000700 WDT size 0x10 — Watchdog Timer
0x40000800 TAUD size 0x400 — Timer Array Unit D
0x40000C00 TAPA size 0x40 — motor control unit
0x40000D00 PIC size 0x100 — Peripheral Inter Connection
0x40000E00 ADC size 0x80 — A/D Converter
0x40010000 SYS size 0x10000 — System
0x40020000 CAN0 size 0x20000 — CAN
0x40040000 CAN1 size 0x20000
0x40070000 ETHSW size 0x10000 — Ethernet Switch
0x40080000 HWOS size 0x10000 — Hardware Real Time OS
0x40090000 ETH size 0x1000 — Ethernet MAC
0x40091000 QINT_BUFID size 0x1000 — Receive Buffer Information
0x400A2000 MEMC size 0x400 — Memory controller (ROM/SRAM)
0x400A2400 SROM size 0x100 — Serial flash ROM memory controller
0x400A2800 DMAC0 size 0x40 — DMA controller
0x400A2840 DMAC1 size 0x40
0x400A2880 DMAC2 size 0x40
0x400A28C0 DMAC3 size 0x40
0x400A2A00 DSS0 size 0x20 — DMAC space source size
0x400A2A20 DSS1 size 0x20
0x400A2A40 DSS2 size 0x20
0x400A2A60 DSS3 size 0x20
0x400A2B00 DCTL size 0x24 — DMA control
0x400A2C00 RTDMAC size 0x40
0x400A2E00 RTDSS size 0x20
0x400A2F00 RTDCTL size 0x24
0x400A3000 GPIO size 0x400 — Port (GPIO)
0x400A3400 RTPORT size 0x400 — Port (RTPORT)
0x400A3800 EXTPORT size 0x400 — Port (EXTPORT)
0x400A4000 CC_Link_IEF_BR size 0x400 — CC-Link IE Field BUS Control
0x400A4400 CC_Link_BR size 0x400 — CC-Link BUS Control
0x400A8000 SMC size 0x200 — Burst memory controller
0x400F8000 CC_Link size 0x4000
0x400FB000 CC_Link_RMT size 0x400 — CC-Link Remote Device Station

## Interrupts
0 TAUJ2I0 (TAUJ2) — TAUJ2 channel 0 interrupt
1 TAUJ2I1 (TAUJ2) — TAUJ2 channel 1 interrupt
2 TAUJ2I2 (TAUJ2) — TAUJ2 channel 2 interrupt
3 TAUJ2I3 (TAUJ2) — TAUJ2 channel 3 interrupt
4 UAJ0TIT (UART0) — UARTJ0 transmission interrupt
5 UAJ0TIR (UART0) — UARTJ0 reception interrupt
6 UAJ1TIT (UART1) — UARTJ1 transmission interrupt
7 UAJ1TIR (UART1) — UARTJ1 reception interrupt
8 CSIH0IC (CSI0) — CSIH0 communication status interrupt
9 CSIH0IR (CSI0) — CSIH0 reception status interrupt
10 CSIH0IJC (CSI0) — CSIH0 job completion interrupt
11 CSIH1IC (CSI1) — CSIH1 communication status interrupt
12 CSIH1IR (CSI1) — CSIH1 reception status interrupt
13 CSIH1IJC (CSI1) — CSIH1 job completion interrupt
14 IICB0TIA (IIC0) — IICB0 data transmission/reception interrupt
15 IICB1TIA (IIC1) — IICB1 data transmission/reception interrupt
16 FCN0REC (CAN0) — FCN0 reception completion interrupt
17 FCN0TRX (CAN0) — FCN0 transmission completion interrupt
18 FCN0WUP (CAN0) — FCN0 sleep and wakeup/transmission suspension interrupt
19 FCN1REC (CAN1) — FCN1 reception completion interrupt
20 FCN1TRX (CAN1) — FCN1 transmission completion interrupt
21 FCN1WUP (CAN1) — FCN1 sleep and wakeup/transmission suspension interrupt
22 DMA00 (DMAC0) — General DMAC channel 0 transfer completion interrupt
23 DMA01 (DMAC1) — General DMAC channel 1 transfer completion interrupt
24 DMA02 (DMAC2) — General DMAC channel 2 transfer completion interrupt
25 DMA03 (DMAC3) — General DMAC channel 3 transfer completion interrupt
26 RTDMA (RTDMAC) — Real-time port DMAC transfer completion interrupt
27 TAUDI0 (TAUD) — TAUD channel 0 interrupt
28 TAUDI1 (TAUD) — TAUD channel 1 interrupt
29 TAUDI2 (TAUD) — TAUD channel 2 interrupt
30 TAUDI3 (TAUD) — TAUD channel 3 interrupt
31 TAUDI4 (TAUD) — TAUD channel 4 interrupt
32 BUFDMA (HWOS) — Inter-buffer DMA transfer completion interrupt
33 ETHPHY0 (ETH) — Gigabit Ethernet PHY Port0 interrupt
34 ETHPHY1 (ETH) — Gigabit Ethernet PHY Port1 interrupt
35 ETHMIICMP (ETH) — Ethernet MII management access completion interrupt
36 ETHPAUSECMP (ETH) — Ethernet pause packet transmission completion interrupt
37 ETHTXCMP (ETH) — Ethernet transmission completion interrupt
38 ETHSW — Ethernet SWITCH interrupt
39 ETHSWDLR (ETHSW) — Ethernet SWITCH DLR interrupt
40 ETHSWSYNC (ETHSW) — Ethernet SWITCH SYNC interrupt
41 ETHRXFIFO (ETH) — RX FIFO overflow interrupt
42 ETHTXFIFO (ETH) — TX FIFO underflow interrupt
43 ETHRXDMA (ETH) — Ethernet MACDMA reception completion interrupt
44 ETHTXDMA (ETH) — Ethernet MACDMA transmission completion interrupt
45 MACDMARXFRM (ETH) — Receive frame successful interrupt
{n+47} INTPZ{n} (GPIO) (n=0..10) — INTPZ{n} input
{n+47} INTPZ{n} (TAUD, GPIO) (n=11..21) — INTPZ{n} input / TAUD channel {n-6} interrupt
69 INTPZ22 (TAPA, GPIO) — INTPZ22 input / peak interrupt (TAPA)
70 INTPZ23 (TAPA, GPIO) — INTPZ23 input / trough interrupt (TAPA)
71 INTPZ24 (GPIO) — INTPZ24 input
72 INTPZ25 (GPIO) — INTPZ25 input
73 INTPZ26 (GPIO) — INTPZ26 input
74 INTPZ27 (GPIO) — INTPZ27 input
75 INTPZ28 (GPIO) — INTPZ28 input
76 HWRTOS (HWOS) — HW-RTOS interrupt
77 BRAMERR (HWOS) — Buffer RAM area access error interrupt
78 IICB0TIS (IIC0) — IICB0 status interrupt
79 IICB1TIS (IIC1) — IICB1 status interrupt
80 WDTA (WDT) — WDT alarm interrupt
81 SFLASH (SROM) — Serial flash ROM controller error interrupt
82 UAJ0TIS (UART0) — UARTJ0 status interrupt
83 UAJ1TIS (UART1) — UARTJ1 status interrupt
84 CSIH0IRE (CSI0) — CSIH0 communication error interrupt
85 CSIH1IRE (CSI1) — CSIH1 communication error interrupt
86 FCN0ERR (CAN0) — FCN0 error detection interrupt
87 FCN1ERR (CAN1) — FCN1 error detection interrupt
88 DERR0 (DMAC0) — General DMAC error response interrupt
89 DERR1 (RTDMAC) — Real-time port DMAC error response interrupt
90 ETHTXFIFOERR (ETH) — Ethernet TX-FIFO error interrupt
91 ETHRXERR (ETH) — Ethernet reception frame error interrupt
92 ETHRXDERR (ETH) — MACDMA reception error interrupt
93 ETHTXDERR (ETH) — MACDMA transmission error interrupt
94 BUFDMAERR (ETH) — Internal buffer DMA error interrupt
95 LED0PHY0 (ETH) — Gigabit Ethernet PHY LED0_PHY0 input interrupt
96 LED0PHY1 (ETH) — Gigabit Ethernet PHY LED0_PHY1 input interrupt
116 CCSIRZ (CC_Link) — CC-Link IRZ interrupt
117 CCSREFSTB (CC_Link) — CC-Link REFSTB interrupt
118 CCSMON3 (CC_Link) — CC-Link MON3 interrupt
121 GBEPHYFLF (ETH) — Gigabit Ethernet PHY FASTLINK_FAIL interrupt
122 LED1PHY0 (ETH) — Gigabit Ethernet PHY LED1_PHY0 input interrupt
123 LED1PHY1 (ETH) — Gigabit Ethernet PHY LED1_PHY1 input interrupt
124 LED2PHY0 (ETH) — Gigabit Ethernet PHY LED2_PHY0 input interrupt
125 LED2PHY1 (ETH) — Gigabit Ethernet PHY LED2_PHY1 input interrupt
127 ADC — AD completion interrupt

## Licence text in the file
Copyright (C) 2014-2015 Renesas Electronics Corporation . This is a sample program. Renesas Electronics assumes no responsibility for any losses incurred.

## Notices in the file
Copyright (C) 2012 ARM Limited. All rights reserved.
