# RIN32M3_CL register map
Vendor: Renesas Electronics Corporation; Series: RIN32M3; File version: 0.1
CPU: CM3 r2p1, little endian, MPU, no FPU, 4 interrupt priority bits
Registers are 32-bit, read-write, reset 0x0 unless marked. A register's access mark holds for its fields unless they carry their own. Offsets are from the block's base; [hi:lo] are bit positions; {n}, {i} and the like mark numbered series.

## HWOS — Hardware Real Time OS
Base 0x40080000
0x00 CNTX_TYPE — Context type
0x04 PRTY — Context priority
0x08 CNTX_STAT — Context status
0x0C INIT_ADD — Initial address
0x10 INIT_R14 — Initial stack point
0x14 WT_RSN — Wait reason
0x18 SMPH_ID — Waitting semaphore ID
0x1C EVNT_ID — Waitting eventflag ID
0x20 EVNT_FLG — Waitting eventflag pattern
0x24 FLG_CND — Eventflag condition (1:and 0:or)
0x28 WT_TIMEOUT — Timeout count
0x2C AT_CLR — Auto flag clear enable
0x30 QUE_ODR — Que order
0x34 HWFUNC_ID — Hardware function ID
0x38 WUP_RQ_QUE — Wakeup request que count
0x3C TO_RQ_ODR — Timeout que
0x4000 EXCPT_MODE — Exception mode
0x4004 EXCPT_CNTX — Exception context
0x4008 EXCPT_ADD — Exception address
0x400C DEBUG_CNTX — Debug context
0x4010 DEBUG_ADD — Debug address
0x4014 WT_TO_PRESCL — Wait time counter to prescale
0x4018 SYS_TIM — System timer
{0x8000+4i} SEM_TBL[{i}] (i=0..127) — Semaphore table
{0x8400+4i} FLG_TBL[{i}] (i=0..63) — Event flag table
{0x8800+4i} HWISR_PNTR[{i}] (i=0..7)
{0x8900+4i} HWISP_OPR[{i}] (i=0..31) — HW-ISR OPR
0x8A00 QINT — HW-ISR QINT
{0x8C00+4i} MBX_TBL[{i}] (i=0..63) — Mailbox table
{0x9000+4i} MBX_ID_TBL[{i}] (i=0..191) — Mailbox ID table
0xF000 SYSC — CPU I/F SYSC
{0xEFF4+4i} R{i}_ (i=4..7) — CPU I/F R{i}
0xF014 CMD — CPU I/F CMD
0xF020 R0_ — CPU I/F R0
0xF024 R1_ — CPU I/F R1
{0x11000+4i} QINTSEL[{i}] (i=0..31) — QINT select registers
0x11100 BUFID

## ETH — Ethernet MAC
Base 0x40090000
0x0C GMAC_TXID — TXID
0x10 GMAC_TXRESULT — TX Result
0x20 GMAC_MODE — MODE
0x24 GMAC_RXMODE — RX MODE
0x28 GMAC_TXMODE — TX MODE
0x2C GMAC_INTENA — Interrupt Enable
0x30 GMAC_RESET — RESET
{0x7C+4i} GMAC_PAUSE{i} (i=1..5) — Pause Packet {i}
0x98 GMAC_FLWCTL — RX Flow Control
0x9C GMAC_PAUSPKT — Pause PKT
0xA0 GMAC_MIIM — MIIM
{0xF8+8i} GMAC_ADR{i}A (i=1..16) — MAC Address {i}A
{0xFC+8i} GMAC_ADR{i}B (i=1..16) — MAC Address {i}B
0x200 GMAC_RXFIFO — RX FIFO
0x204 GMAC_TXFIFO — TX FIFO
0x208 GMAC_ACC — TCPIP Acc
0x210 GMAC_ACC_ELST — TCPIP Acc external list
0x220 GMAC_RXMAC_ENA — RXMAC Enable
0x224 GMAC_LPI_MODE — LPI Mode
0x228 GMAC_LPI_TIMING — LPI Timing

## MEMC — Memory controller (ROM/SRAM)
Base 0x400A2000
0x04 BSC reset 0xFFFF — Bus Size Control register
{0x8+4i} SMC{i} reset 0xFFFF (i=0..3) — Static Memory Control register {i}
0x18 PRC reset 0xF0000000 — Page Rom Control register

## SROM — Serial flash ROM memory controller
Base 0x400A2400
0x00 SFMSMD reset 0x110 — Transfer mode control register
0x04 SFMSSC reset 0x37 — Chip select control register
0x08 SFMSKC reset 0x8 — Clock control register
0x0C SFMSST ro reset 0x80 — Status register
0x10 SFMCOM (reset mask 0xFFFFFF) — Communication port register
0x14 SFMCMD — Communication mode control register
0x18 SFMCST — Communication status register

## DMAC0 — DMA controller
Base 0x400A2800
Same registers: DMAC1 0x400A2840, DMAC2 0x400A2880, DMAC3 0x400A28C0, RTDMAC 0x400A2C00
0x00 N0SAn — Source address register [Next0]
0x04 N0DAn — Destination address register [Next0]
0x08 N0TBn — Transaction byte register [Next0]
0x0C N1SAn — Source address register [Next1]
0x10 N1DAn — Destination address register [Next1]
0x14 N1TBn — Transaction byte register [Next1]
0x18 CRSAn ro — Source address register [Current]
0x1C CRDAn ro — Destination address register [Current]
0x20 CRTBn ro — Transaction byte register [Current]
0x24 CHSTATn ro — Channel status register
0x28 CHCTRLn wo — Channel control register
0x2C CHCFGn — Channel configulation register
0x30 CHITVLn — Channel intereval register
0x38 NXLAn — Link address register [Next]
0x3C CRLAn ro — Link address register [Current]
