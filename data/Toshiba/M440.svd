# M440 register map
File version: 0.1
TOSHIBA Cortex-M4 MCU
Registers are 32-bit, read-write, reset 0x0 unless marked. A register's access mark holds for its fields unless they carry their own. Offsets are from the block's base; lines under a group give offsets from that group; [hi:lo] are bit positions; {n}, {i} and the like mark numbered series; 'fields as' and 'values as' point back to an identical list; <NAME> marks a mode.

## Memory map
0x40000000 DMACA blocks up to offset 0x134 — DMA Controller
0x40001000 DMACB blocks up to offset 0x134
0x40002000 DMACC blocks up to offset 0x134
0x40018000 PSC blocks up to offset 0x710C — Programmable Servo Controller
0x40040000 SSP size 0x28 — Synchronous Serial Port
0x40058000 TD blocks up to offset 0x58 — Timer D-common
0x40058000 TD0 blocks up to offset 0x12C — Timer D-unit0
0x40058000 TD1 blocks up to offset 0x140 — Timer D-unit1
0x40074000 AD_MIRA blocks up to offset 0x78 — 12bit A_D Converter for PSC
0x40075000 EPHC_MIR blocks up to offset 0x70 — Enhannced Two Aspect Pulse Input Counter (Enhannced 2-Phase Pulse Input Timer) (EPHC) for PSC
0x40079000 AD_MIRB blocks up to offset 0x78
0x4007A000 AD_MIRC blocks up to offset 0x78 — 12bit A_D Converter for PSC
0x400C0000 PA blocks up to offset 0x3C — Port A
0x400C0100 PB blocks up to offset 0x3C — Port B
0x400C0200 PC blocks up to offset 0x3C — Port C
0x400C0300 PD blocks up to offset 0x3C — Port D
0x400C0400 PE blocks up to offset 0x3C — Port E
0x400C0500 PF blocks up to offset 0x3C — Port F
0x400C0600 PG blocks up to offset 0x3C — Port G
0x400C0700 PH blocks up to offset 0x3C — Port H
0x400C0800 PJ blocks up to offset 0x3C — Port J
0x400C0900 PK blocks up to offset 0x3C — Port K
0x400C0A00 PL blocks up to offset 0x3C — Port L
0x400C0B00 PM blocks up to offset 0x3C — Port M
0x400C0C00 PN blocks up to offset 0x3C — Port N
0x400C0D00 PP blocks up to offset 0x3C — Port P
0x400C0E00 PR blocks up to offset 0x3C — Port R
0x400C0F00 PT blocks up to offset 0x3C — Port T
0x400C1000 PU blocks up to offset 0x3C — Port U
0x400C1100 PV blocks up to offset 0x3C — Port V
0x400C1200 PW blocks up to offset 0x3C — Port W
0x400C1300 PY blocks up to offset 0x3C — Port Y
0x400C1400 PAA blocks up to offset 0x3C — Port AA
0x400C1500 PAB blocks up to offset 0x3C — Port AB
0x400C1600 PAC blocks up to offset 0x3C — Port AC
0x400C1700 PAD blocks up to offset 0x3C — Port AD
0x400C1800 PAE blocks up to offset 0x3C — Port AE
0x400C1900 PAF blocks up to offset 0x3C — Port AF
0x400C1A00 PAG blocks up to offset 0x3C — Port AG
0x400C1B00 PAH blocks up to offset 0x3C — Port AH
0x400C1C00 PAJ blocks up to offset 0x3C — Port AJ
{0x400C4600+0x100*n} TB{n} size 0x34 (n=10..19)
0x400CA000 PHC0 size 0x20 — Two-phase Pulse Input Count
0x400CA100 PHC1 size 0x20
0x400CC000 RTC blocks up to offset 0xD — Real Time Clock (RTC)
0x400E0000 SBI size 0x18 — Serial Bus Interface (SBI)
0x400F2000 WD size 0x8 — Watchdog Timer (WD)
0x400F3000 CG blocks up to offset 0x68 — Clock Generator (CG)
0x400FA000 KS size 0x28 — Key Matrix Scan
0x400FB000 KWUPA size 0x90 — Key On Wake Up
0x400FB100 KWUPB blocks up to offset 0x90 — Key On Wake Up
0x41FFF000 FC blocks up to offset 0x34 — Flash Control (FC)
0x44048000 UART0 blocks up to offset 0x4C — UART
0x44049000 UART1 blocks up to offset 0x4C
0x44050000 ADA blocks up to offset 0x78 — 12bit A_D Converter
0x44051000 ADB blocks up to offset 0x78
0x44052000 ADC blocks up to offset 0x78 — 12bit A_D Converter
0x44054000 DAA size 0x8 — 10bit D_A Converter
0x44055000 DAB size 0x8
0x4405C000 EXB blocks up to offset 0x50 — External Bus Interface(EXB)
0x4405F000 DMACNone size 0x8 — DMA Controller
0x44060000 EPHC blocks up to offset 0x70 — Enhannced Two Aspect Pulse Input Counter (Enhannced 2-Phase Pulse Input Timer) (EPHC) for CPU
0x4406A000 ESIO0 blocks up to offset 0x21C — Enhannced Serial I_O (ESIO)
0x4406B000 ESIO1 blocks up to offset 0x21C
0x4406C000 ESIO2 blocks up to offset 0x21C
0x440C4000 TB0 size 0x34 — 16-bit Timer_Event Counter (TB)
{0x440C4000+0x100*n} TB{n} size 0x34 (n=1..9)
0x440CE000 TC blocks up to offset 0xD8 — 32-bit Timer (TC)
0x440E1000 SC0 size 0x38 — Serial Channel (SC)
0x440E1100 SC1 size 0x38
0x440E1200 SC2 size 0x38
0x440E1300 SC3 size 0x38 — Serial Channel (SC)
0x440E1400 SC4 size 0x38
0x440E1500 SC5 size 0x38
