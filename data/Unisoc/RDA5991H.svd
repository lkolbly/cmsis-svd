# RDA5991H register map
Vendor: Unisoc; File version: 1.0.0
Register cmsis file for RDA5981 parts
CPU: CM4 r1p4, little endian, MPU, FPU, 5 interrupt priority bits
Registers are 32-bit, access not given, reset 0x0 unless marked. A register's access mark holds for its fields unless they carry their own. Offsets are from the block's base; lines under a group give offsets from that group; [hi:lo] are bit positions; {n}, {i} and the like mark numbered series; 'fields as' and 'values as' point back to an identical list; <NAME> marks a mode.

## Memory map
0x40001000 RDA_GPIO size 0x68
0x40002000 RDA_TIMER size 0x24
0x40003000 RDA_I2C0 size 0x18
0x40013000 RDA_SPI0 size 0xC

## Interrupts
0 SPIFLASH_IRQn (RDA_SPI0) — description interrupt RDA_SPI0
5 GPIO_IRQn (RDA_GPIO) — description interrupt RDA_GPIO
6 TIMER_IRQn (RDA_TIMER) — description interrupt RDA_TIMER
14 I2C_IRQn (RDA_I2C0) — description interrupt RDA_I2C0

## RDA_SPI0
Base 0x40013000
0x00 CFG reset 0x191420 — description spi_cfg
  [0] EN — Enable
    0=Disable (Timer is disabled and does not operate); 1=Enable (Timer is enabled and can operate)
0x04 D0CMD — description cmd_data0
0x08 D1CMD — description cmd_data1

## RDA_I2C0
Base 0x40003000
0x00 CR0 reset 0xFFFF — Control Register 0
0x04 SR reset 0x7C000000 — Status Register
0x08 DR — TX/RX Data Register
0x0C CMD — Command Register
0x10 ICR — Interrupt Clear Register
0x14 CR1 — Control Register 1

## RDA_GPIO
Base 0x40001000
0x00 CTRL reset 0x30003000 — GPIO Control
0x08 DOUT — GPIO Data Output
0x0C DIN reset 0x100 — GPIO Data Input
0x10 DIR reset 0x3C03C01 — GPIO Direction
0x14 SLEW0 — GPIO Slew Config 0
0x18 SLEWIOMUX — GPIO IOMUX Slew Config
0x1C INTCTRL — GPIO Interrupt Control
0x20 IFCTRL — Interface Control
0x24 SLEW1 — GPIO Slew Config 1
0x28 REVID reset 0x5991 — ASIC Reversion ID
0x2C LPOSEL — LPO Select
0x34 INTSEL — GPIO Interrupt Select
0x3C SDIOCFG reset 0x5A5A5A5A — SDIO Config
0x40 MEMCFG reset 0x8842 — Memory Config
{0x44+4i} IOMUXCTRL[{i}] (i=0..7) — IOMUX Control
0x64 PCCTRL — Pulse Counter Control

## RDA_TIMER
Base 0x40002000
0x00 LDCNT — Timer Load Count Register
0x04 CVAL — Current Timer Value Register
0x08 TCTRL — Timer Control Register
0x0C INTCLR — Interrupt Clear Register
0x10 INTST — Timer Int Stat Register
0x14 LDCNT1 — Timer1 Load Count Register
0x18 CVAL1 — Current Timer1 Value Register
0x20 INTCLR1 — timer1 Interrupt Clear Register

## Notices in the file
Copyright (C) 2012-2014 ARM Limited. All rights reserved.
Purpose: System Viewer Description (SVD) Example (Schema Version 1.1)
This is a description of a none-existent and incomplete device
for demonstration purposes only.
Redistribution and use in source and binary forms, with or without
modification, are permitted provided that the following conditions are met:
- Redistributions of source code must retain the above copyright
notice, this list of conditions and the following disclaimer.
- Redistributions in binary form must reproduce the above copyright
notice, this list of conditions and the following disclaimer in the
documentation and/or other materials provided with the distribution.
- Neither the name of ARM nor the names of its contributors may be used
to endorse or promote products derived from this software without
specific prior written permission.
THIS SOFTWARE IS PROVIDED BY THE COPYRIGHT HOLDERS AND CONTRIBUTORS "AS IS"
AND ANY EXPRESS OR IMPLIED WARRANTIES, INCLUDING, BUT NOT LIMITED TO, THE
IMPLIED WARRANTIES OF MERCHANTABILITY AND FITNESS FOR A PARTICULAR PURPOSE
ARE DISCLAIMED. IN NO EVENT SHALL COPYRIGHT HOLDERS AND CONTRIBUTORS BE
LIABLE FOR ANY DIRECT, INDIRECT, INCIDENTAL, SPECIAL, EXEMPLARY, OR
CONSEQUENTIAL DAMAGES (INCLUDING, BUT NOT LIMITED TO, PROCUREMENT OF
SUBSTITUTE GOODS OR SERVICES; LOSS OF USE, DATA, OR PROFITS; OR BUSINESS
INTERRUPTION) HOWEVER CAUSED AND ON ANY THEORY OF LIABILITY, WHETHER IN
CONTRACT, STRICT LIABILITY, OR TORT (INCLUDING NEGLIGENCE OR OTHERWISE)
ARISING IN ANY WAY OUT OF THE USE OF THIS SOFTWARE, EVEN IF ADVISED OF THE
POSSIBILITY OF SUCH DAMAGE.
