# ATSAML21J17A register map
Vendor: Atmel Corporation; Series: SAML21; File version: A
Atmel ATSAML21J17A device: Cortex-M0+ Microcontroller with 128KB Flash, 16KB SRAM, 64-pin package (refer to http://www.atmel.com/devices/SAML21J17A.aspx for more)
CPU: CM0+ r0p1, little endian, no MPU, no FPU, VTOR, 2 interrupt priority bits
Registers are 32-bit, read-write, reset 0x0 unless marked. A register's access mark holds for its fields unless they carry their own. Offsets are from the block's base; lines under a group give offsets from that group; [hi:lo] are bit positions; {n}, {i} and the like mark numbered series; 'fields as' and 'values as' point back to an identical list; <NAME> marks a mode.

## Memory map
0x40000000 PM size 0x80 — Power Manager
0x40000400 MCLK size 0x80 — Main Clock
0x40000800 RSTC size 0x20 — Reset Controller
0x40000C00 OSCCTRL size 0x80 — Oscillators Control
0x40001000 OSC32KCTRL size 0x80 — 32k Oscillators Control
0x40001400 SUPC size 0x80 — Supply Controller
0x40001800 GCLK size 0x200 — Generic Clock Generator
0x40001C00 WDT size 0x10 — Watchdog Timer
0x40002000 RTC size 0x80 — Real-Time Counter
0x40002400 EIC size 0x40 — External Interrupt Controller
0x40002800 PORT size 0x200 — Port Module
0x40002C00 TAL size 0x80 — Trigger Allocator
0x41000000 USB size 0x400 — Universal Serial Bus
0x41002000 DSU size 0x2000 — Device Service Unit
0x41004000 NVMCTRL size 0x80 — Non-Volatile Memory Controller
0x41006000 MTB size 0x1000 — Cortex-M0+ Micro-Trace Buffer
0x42000000 SERCOM0 size 0x40 — Serial Communication Interface 0
0x42000400 SERCOM1 size 0x40 — Serial Communication Interface 1
0x42000800 SERCOM2 size 0x40 — Serial Communication Interface 2
0x42000C00 SERCOM3 size 0x40 — Serial Communication Interface 3
0x42001000 SERCOM4 size 0x40 — Serial Communication Interface 4
0x42001400 TCC0 size 0x90 — Timer Counter Control 0
0x42001800 TCC1 size 0x90 — Timer Counter Control 1
0x42001C00 TCC2 size 0x90 — Timer Counter Control 2
0x42002000 TC0 size 0x40 — Basic Timer Counter 0
0x42002400 TC1 size 0x40 — Basic Timer Counter 1
0x42002800 TC2 size 0x40 — Basic Timer Counter 2
0x42002C00 TC3 size 0x40 — Basic Timer Counter 3
0x42003000 DAC size 0x20 — Digital-to-Analog Converter
0x42003400 AES size 0x100 — Advanced Encryption Standard
0x42003800 TRNG size 0x100 — True Random Generator
0x43000000 EVSYS size 0x400 — Event System Interface
0x43000400 SERCOM5 size 0x40 — Serial Communication Interface 5
0x43000800 TC4 size 0x40 — Basic Timer Counter 4
0x43000C00 ADC size 0x80 — Analog Digital Converter
0x43001000 AC size 0x40 — Analog Comparators
0x43001800 OPAMP size 0x10 — Operational Amplifier
0x43001C00 CCL size 0x40 — Configurable Custom Logic
0x44000000 PAC size 0x80 — Peripheral Access Controller
0x44000400 DMAC size 0x80 — Direct Memory Access Controller

## Interrupts
0 SYSTEM (MCLK, OSCCTRL, OSC32KCTRL, PAC, PM, SUPC, TAL)
1 WDT
2 RTC
3 EIC
4 NVMCTRL
5 DMAC
6 USB
7 EVSYS
8 SERCOM0
9 SERCOM1
10 SERCOM2
11 SERCOM3
12 SERCOM4
13 SERCOM5
14 TCC0
15 TCC1
16 TCC2
17 TC0
18 TC1
19 TC2
20 TC3
21 TC4
22 ADC
23 AC
24 DAC
26 AES
27 TRNG

## Licence text in the file
============================================================================ Atmel Microcontroller Software Support ============================================================================ Copyright (c) 2015, Atmel Corporation . All rights reserved. . Redistribution and use in source and binary forms, with or without modification, are permitted provided that the following condition is met: - Redistributions of source code must retain the above copyright notice, this list of conditions and the disclaimer below. . Atmel's name may not be used to endorse or promote products derived from this software without specific prior written permission. . DISCLAIMER: THIS SOFTWARE IS PROVIDED BY ATMEL "AS IS" AND ANY EXPRESS OR. IMPLIED WARRANTIES, INCLUDING, BUT NOT LIMITED TO, THE IMPLIED WARRANTIES OF. MERCHANTABILITY, FITNESS FOR A PARTICULAR PURPOSE AND NON-INFRINGEMENT ARE. DISCLAIMED. IN NO EVENT SHALL ATMEL BE LIABLE FOR ANY DIRECT, INDIRECT, INCIDENTAL, SPECIAL, EXEMPLARY, OR CONSEQUENTIAL DAMAGES (INCLUDING, BUT NOT. LIMITED TO, PROCUREMENT OF SUBSTITUTE GOODS OR SERVICES; LOSS OF USE, DATA, OR PROFITS; OR BUSINESS INTERRUPTION) HOWEVER CAUSED AND ON ANY THEORY OF. LIABILITY, WHETHER IN CONTRACT, STRICT LIABILITY, OR TORT (INCLUDING. NEGLIGENCE OR OTHERWISE) ARISING IN ANY WAY OUT OF THE USE OF THIS SOFTWARE, EVEN IF ADVISED OF THE POSSIBILITY OF SUCH DAMAGE. ============================================================================
