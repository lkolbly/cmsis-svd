# ATSAMG55J19 register map
Vendor: Atmel; Series: SAMG55; File version: 0
Atmel ATSAMG55J19 Microcontroller
CPU: CM4 r0p1, selectable endian, MPU, FPU, 4 interrupt priority bits
Registers are 32-bit, read-write, reset 0x0 unless marked. A register's access mark holds for its fields unless they carry their own. Offsets are from the block's base; lines under a group give offsets from that group; [hi:lo] are bit positions; {n}, {i} and the like mark numbered series; 'fields as' and 'values as' point back to an identical list; <NAME> marks a mode.

## Memory map
0x40000000 I2SC0 size 0x4000 — Inter-IC Sound Controller 0
0x40004000 I2SC1 size 0x4000 — Inter-IC Sound Controller 1
0x40008000 FLEXCOM5 size 0x100 — Flexible Serial Communication 5
0x40008200 USART5 size 0x200 — Universal Synchronous Asynchronous Receiver Transmitter 5
0x40008400 SPI5 size 0x200 — Serial Peripheral Interface 5
0x40008600 TWI5 size 0x200 — Two-wire Interface 5
0x4000C000 FLEXCOM0 size 0x100 — Flexible Serial Communication 0
0x4000C200 USART0 size 0x128 — Universal Synchronous Asynchronous Receiver Transmitter 0
0x4000C400 SPI0 size 0x128 — Serial Peripheral Interface 0
0x4000C600 TWI0 size 0x128 — Two-wire Interface 0
0x40010000 TC0 size 0x4000 — Timer Counter 0
0x40014000 TC1 size 0x4000 — Timer Counter 1
0x40018000 FLEXCOM3 size 0x4000 — Flexible Serial Communication 3
0x40018200 USART3 size 0x4000 — Universal Synchronous Asynchronous Receiver Transmitter 3
0x40018400 SPI3 size 0x4000 — Serial Peripheral Interface 3
0x40018600 TWI3 size 0x4000 — Two-wire Interface 3
0x4001C000 FLEXCOM4 size 0x4000 — Flexible Serial Communication 4
0x4001C200 USART4 size 0x4000 — Universal Synchronous Asynchronous Receiver Transmitter 4
0x4001C400 SPI4 size 0x4000 — Serial Peripheral Interface 4
0x4001C600 TWI4 size 0x4000 — Two-wire Interface 4
0x40020000 FLEXCOM1 size 0x4000 — Flexible Serial Communication 1
0x40020200 USART1 size 0x4000 — Universal Synchronous Asynchronous Receiver Transmitter 1
0x40020400 SPI1 size 0x4000 — Serial Peripheral Interface 1
0x40020600 TWI1 size 0x4000 — Two-wire Interface 1
0x40024000 FLEXCOM2 size 0x4000 — Flexible Serial Communication 2
0x40024200 USART2 size 0x4000 — Universal Synchronous Asynchronous Receiver Transmitter 2
0x40024400 SPI2 size 0x4000 — Serial Peripheral Interface 2
0x40024600 TWI2 size 0x4000 — Two-wire Interface 2
0x40028000 MEM2MEM size 0x4000 — Memory to Memory
0x4002C000 PDMIC0 size 0x4000 — Pulse Density Modulation Interface Controller 0
0x40030000 PDMIC1 size 0x4000 — Pulse Density Modulation Interface Controller 1
0x40034000 FLEXCOM7 size 0x100 — Flexible Serial Communication 7
0x40034200 USART7 size 0x128 — Universal Synchronous Asynchronous Receiver Transmitter 7
0x40034400 SPI7 size 0x128 — Serial Peripheral Interface 7
0x40034600 TWI7 size 0x128 — Two-wire Interface 7
0x40038000 ADC size 0x4000 — Analog-to-Digital Converter
0x4003C000 CMCC size 0x4000 — Cortex-M Cache Controller
0x40040000 FLEXCOM6 size 0x100 — Flexible Serial Communication 6
0x40040200 USART6 size 0x128 — Universal Synchronous Asynchronous Receiver Transmitter 6
0x40040400 SPI6 size 0x128 — Serial Peripheral Interface 6
0x40040600 TWI6 size 0x128 — Two-wire Interface 6
0x40044000 UDP size 0x4000 — USB Device Port
0x40048000 CRCCU size 0x4000 — Cyclic Redundancy Check Calculation Unit
0x4004C000 UHP size 0x8F000 — USB Host Port
0x400E0200 MATRIX size 0x200 — AHB Bus Matrix
0x400E0400 PMC size 0x140 — Power Management Controller
0x400E0740 CHIPID size 0x200 — Chip Identifier
0x400E0A00 EFC size 0x200 — Embedded Flash Controller
0x400E0E00 PIOA size 0x200 — Parallel Input/Output Controller A
0x400E1000 PIOB size 0x200 — Parallel Input/Output Controller B
0x400E1400 RSTC size 0x200 — Reset Controller
0x400E1410 SUPC size 0x200 — Supply Controller
0x400E1430 RTT size 0x200 — Real-time Timer
0x400E1450 WDT size 0x200 — Watchdog Timer
0x400E1460 RTC size 0x200 — Real-time Clock
0x400E1490 GPBR size 0x200 — General Purpose Backup Registers

## Interrupts
5 PMC
6 EFC
7 USART7
8 USART0
9 USART1
11 PIOA
12 PIOB
13 PDMIC0
14 USART2
15 MEM2MEM
16 I2SC0
17 I2SC1
18 PDMIC1
19 USART3
20 USART4
21 USART5
22 USART6
23 TC0
24 TC1 (TC0)
25 TC2 (TC0)
26 TC3 (TC1)
27 TC4 (TC1)
28 TC5 (TC1)
29 ADC
47 UHP
48 UDP
49 CRCCU

## Notices in the file
SAM Software Package License
Copyright (c) 2014, Atmel Corporation
All rights reserved.
Redistribution and use in source and binary forms, with or without
modification, are permitted provided that the following condition is met:
- Redistributions of source code must retain the above copyright notice,
this list of conditions and the disclaimer below.
Atmel's name may not be used to endorse or promote products derived from
this software without specific prior written permission.
DISCLAIMER:  THIS SOFTWARE IS PROVIDED BY ATMEL "AS IS" AND ANY EXPRESS OR
IMPLIED WARRANTIES, INCLUDING, BUT NOT LIMITED TO, THE IMPLIED WARRANTIES OF
MERCHANTABILITY, FITNESS FOR A PARTICULAR PURPOSE AND NON-INFRINGEMENT ARE
DISCLAIMED. IN NO EVENT SHALL ATMEL BE LIABLE FOR ANY DIRECT, INDIRECT,
INCIDENTAL, SPECIAL, EXEMPLARY, OR CONSEQUENTIAL DAMAGES (INCLUDING, BUT NOT
LIMITED TO, PROCUREMENT OF SUBSTITUTE GOODS OR SERVICES; LOSS OF USE, DATA,
OR PROFITS; OR BUSINESS INTERRUPTION) HOWEVER CAUSED AND ON ANY THEORY OF
LIABILITY, WHETHER IN CONTRACT, STRICT LIABILITY, OR TORT (INCLUDING
NEGLIGENCE OR OTHERWISE) ARISING IN ANY WAY OUT OF THE USE OF THIS SOFTWARE,
EVEN IF ADVISED OF THE POSSIBILITY OF SUCH DAMAGE.
