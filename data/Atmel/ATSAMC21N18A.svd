# ATSAMC21N18A register map
Vendor: Atmel Corporation; Series: SAMC21; File version: A
Atmel ATSAMC21N18A device: Cortex-M0+ Microcontroller with 256KB Flash, 32KB SRAM, 100-pin package (refer to http://www.atmel.com/devices/SAMC21N18A.aspx for more)
CPU: CM0+ r0p1, little endian, MPU, no FPU, VTOR, 2 interrupt priority bits
Registers are 32-bit, read-write, reset 0x0 unless marked. A register's access mark holds for its fields unless they carry their own. Offsets are from the block's base; lines under a group give offsets from that group; [hi:lo] are bit positions; {n}, {i} and the like mark numbered series; 'fields as' and 'values as' point back to an identical list; <NAME> marks a mode.

## Memory map
0x40000000 PAC size 0x80 — Peripheral Access Controller
0x40000400 PM size 0x80 — Power Manager
0x40000800 MCLK size 0x80 — Main Clock
0x40000C00 RSTC size 0x20 — Reset Controller
0x40001000 OSCCTRL size 0x80 — Oscillators Control
0x40001400 OSC32KCTRL size 0x80 — 32k Oscillators Control
0x40001800 SUPC size 0x80 — Supply Controller
0x40001C00 GCLK size 0x200 — Generic Clock Generator
0x40002000 WDT size 0x10 — Watchdog Timer
0x40002400 RTC size 0x80 — Real-Time Counter
0x40002800 EIC size 0x40 — External Interrupt Controller
0x40002C00 FREQM size 0x20 — Frequency Meter
0x40003000 TSENS size 0x40 — Temperature Sensor
0x41000000 PORT size 0x200 — Port Module
0x41002000 DSU size 0x2000 — Device Service Unit
0x41004000 NVMCTRL size 0x80 — Non-Volatile Memory Controller
0x41006000 DMAC size 0x80 — Direct Memory Access Controller
0x41008000 MTB size 0x1000 — Cortex-M0+ Micro-Trace Buffer
0x4100A000 HMATRIXHS size 0x150 — HSB Matrix
0x42000000 EVSYS size 0x400 — Event System Interface
0x42000400 SERCOM0 size 0x40 — Serial Communication Interface 0
0x42000800 SERCOM1 size 0x40 — Serial Communication Interface 1
0x42000C00 SERCOM2 size 0x40 — Serial Communication Interface 2
0x42001000 SERCOM3 size 0x40 — Serial Communication Interface 3
0x42001400 SERCOM4 size 0x40 — Serial Communication Interface 4
0x42001800 SERCOM5 size 0x40 — Serial Communication Interface 5
0x42001C00 CAN0 size 0x200 — Control Area Network 0
0x42002000 CAN1 size 0x200 — Control Area Network 1
0x42002400 TCC0 size 0x90 — Timer Counter Control 0
0x42002800 TCC1 size 0x90 — Timer Counter Control 1
0x42002C00 TCC2 size 0x90 — Timer Counter Control 2
0x42003000 TC0 size 0x40 — Basic Timer Counter 0
0x42003400 TC1 size 0x40 — Basic Timer Counter 1
0x42003800 TC2 size 0x40 — Basic Timer Counter 2
0x42003C00 TC3 size 0x40 — Basic Timer Counter 3
0x42004000 TC4 size 0x40 — Basic Timer Counter 4
0x42004400 ADC0 size 0x80 — Analog Digital Converter 0
0x42004800 ADC1 size 0x80 — Analog Digital Converter 1
0x42004C00 SDADC size 0x40 — Sigma-Delta Analog Digital Converter
0x42005000 AC size 0x40 — Analog Comparators
0x42005400 DAC size 0x20 — Digital Analog Converter
0x42005C00 CCL size 0x40 — Configurable Custom Logic
0x42006000 TAL size 0x80 — Trigger Allocator
0x43000000 SERCOM6 size 0x40 — Serial Communication Interface 6
0x43000400 SERCOM7 size 0x40 — Serial Communication Interface 7
0x43000800 TC5 size 0x40 — Basic Timer Counter 5
0x43000C00 TC6 size 0x40 — Basic Timer Counter 6
0x43001000 TC7 size 0x40 — Basic Timer Counter 7
0x48000000 DIVAS size 0x20 — Divide and Square Root Accelerator
0x60000000 PORT_IOBUS size 0x200 — Port Module (IOBUS)
0x60000200 DIVAS_IOBUS size 0x20 — Divide and Square Root Accelerator (IOBUS)

## Interrupts
0 SYSTEM_INTREQ (MCLK, OSCCTRL, OSC32KCTRL, PAC, PM, SUPC, TAL)
1 WDT_INTREQ (WDT)
2 RTC_INTREQ (RTC)
3 EIC_INTREQ (EIC)
4 FREQM_INTREQ (FREQM)
5 TSENS_INTREQ (TSENS)
6 NVMCTRL_INTREQ (NVMCTRL)
7 DMAC_INTREQ (DMAC)
8 EVSYS_INTREQ (EVSYS)
9 SERCOM0_6_INTREQ (SERCOM0, SERCOM6)
10 SERCOM1_7_INTREQ (SERCOM1, SERCOM7)
11 SERCOM2_INTREQ (SERCOM2)
12 SERCOM3_INTREQ (SERCOM3)
13 SERCOM4_INTREQ (SERCOM4)
14 SERCOM5_INTREQ (SERCOM5)
15 CAN0_INTREQ (CAN0)
16 CAN1_INTREQ (CAN1)
17 TCC0_INTREQ (TCC0)
18 TCC1_INTREQ (TCC1)
19 TCC2_INTREQ (TCC2)
20 TC0_5_INTREQ (TC0, TC5)
21 TC1_6_INTREQ (TC1, TC6)
22 TC2_7_INTREQ (TC2, TC7)
23 TC3_INTREQ (TC3)
24 TC4_INTREQ (TC4)
25 ADC0_INTREQ (ADC0)
26 ADC1_INTREQ (ADC1)
27 AC_INTREQ (AC)
28 DAC_INTREQ (DAC)
29 SDADC_INTREQ (SDADC)

## Licence text in the file
============================================================================ Atmel Microcontroller Software Support ============================================================================ Copyright (c) 2017 Atmel Corporation, a wholly owned subsidiary of Microchip Technology Inc. . Licensed under the Apache License, Version 2.0 (the "License"); you may not use this file except in compliance with the License. You may obtain a copy of the Licence at http://www.apache.org/licenses/LICENSE-2.0 . Unless required by applicable law or agreed to in writing, software distributed under the License is distributed on an "AS IS" BASIS, WITHOUT WARRANTIES OR CONDITIONS OF ANY KIND, either express or implied. See the License for the specific language governing permissions and limitations under the License. ============================================================================
