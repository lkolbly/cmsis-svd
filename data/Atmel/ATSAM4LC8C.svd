# ATSAM4LC8C register map
Vendor: Atmel Corporation; Series: SAM4L; File version: A
Atmel ATSAM4LC8C device: Cortex-M4 Microcontroller with 512KB Flash, 64KB SRAM, 100-pin package (refer to http://www.atmel.com/devices/SAM4LC8C.aspx for more)
CPU: CM4 r0p1, little endian, MPU, no FPU, 4 interrupt priority bits
Registers are 32-bit, write-only, reset 0x0 unless marked. A register's access mark holds for its fields unless they carry their own. Offsets are from the block's base; lines under a group give offsets from that group; [hi:lo] are bit positions; {n}, {i} and the like mark numbered series; 'fields as' and 'values as' point back to an identical list; <NAME> marks a mode.

## Memory map
0x40004000 IISC size 0x400 — Inter-IC Sound (I2S) Controller
0x40008000 SPI size 0x400 — Serial Peripheral Interface
0x40010000 TC0 size 0x400 — Timer/Counter 0
0x40014000 TC1 size 0x400 — Timer/Counter 1
0x40018000 TWIM0 size 0x400 — Two-wire Master Interface 0
0x40018400 TWIS0 size 0x400 — Two-wire Slave Interface 0
0x4001C000 TWIM1 size 0x400 — Two-wire Master Interface 1
0x4001C400 TWIS1 size 0x400 — Two-wire Slave Interface 1
0x40024000 USART0 size 0x400 — Universal Synchronous Asynchronous Receiver Transmitter 0
0x40028000 USART1 size 0x400 — Universal Synchronous Asynchronous Receiver Transmitter 1
0x4002C000 USART2 size 0x400 — Universal Synchronous Asynchronous Receiver Transmitter 2
0x40030000 USART3 size 0x400 — Universal Synchronous Asynchronous Receiver Transmitter 3
0x40038000 ADCIFE size 0x400 — ADC controller interface
0x4003C000 DACC size 0x400 — DAC Controller
0x40040000 ACIFC size 0x400 — Analog Comparator Interface
0x40060000 GLOC size 0x400 — Glue Logic Controller
0x40064000 ABDACB size 0x400 — Audio Bitstream DAC
0x40068000 TRNG size 0x400 — True Random Number Generator
0x4006C000 PARC size 0x400 — Parallel Capture
0x40070000 CATB size 0x400 — Capacitive Touch Module B
0x40078000 TWIM2 size 0x400 — Two-wire Master Interface 2
0x4007C000 TWIM3 size 0x400 — Two-wire Master Interface 3
0x40080000 LCDCA size 0x400 — LCD Controller
0x400A0000 HFLASHC size 0x400 — Flash Controller
0x400A0400 HCACHE size 0x100 — Cortex M I&D Cache Controller
0x400A1000 HMATRIX size 0x400 — HSB Matrix
0x400A2000 PDCA size 0x1000 — Peripheral DMA Controller
0x400A3000 SMAP size 0x400 — System Manager Access Port
0x400A4000 CRCCU size 0x400 — CRC Calculation Unit
0x400A5000 USBC size 0x1000 — USB 2.0 Interface
0x400A6000 PEVC size 0x400 — Peripheral Event Controller
0x400B0000 AESA size 0x100 — Advanced Encryption Standard
0x400E0000 PM size 0x400 — Power Manager
0x400E0400 CHIPID size 0x400 — Chip ID Registers
0x400E0800 SCIF size 0x400 — System Control Interface
0x400E0C00 FREQM size 0x400 — Frequency Meter
0x400E1000 GPIO size 0x1000 — General-Purpose Input/Output Controller
0x400F0000 BPM size 0x400 — Backup Power Manager
0x400F0400 BSCIF size 0x400 — Backup System Control Interface
0x400F0800 AST size 0x400 — Asynchronous Timer
0x400F0C00 WDT size 0x400 — Watchdog Timer
0x400F1000 EIC size 0x400 — External Interrupt Controller
0x400F1400 PICOUART size 0x400

## Interrupts
0 HFLASHC
{n+1} PDCA_{n} (PDCA) (n=0..15)
17 CRCCU
18 USBC
19 PEVC_TR (PEVC)
20 PEVC_OV (PEVC)
21 AESA
22 PM
23 SCIF
24 FREQM
{n+25} GPIO_{n} (GPIO) (n=0..11)
37 BPM
38 BSCIF
39 AST_ALARM (AST)
40 AST_PER (AST)
41 AST_OVF (AST)
42 AST_READY (AST)
43 AST_CLKREADY (AST)
44 WDT
{n+44} EIC_{n} (EIC) (n=1..8)
53 IISC
54 SPI
55 TC00 (TC0)
56 TC01 (TC0)
57 TC02 (TC0)
58 TC10 (TC1)
59 TC11 (TC1)
60 TC12 (TC1)
61 TWIM0
62 TWIS0
63 TWIM1
64 TWIS1
65 USART0
66 USART1
67 USART2
68 USART3
69 ADCIFE
70 DACC
71 ACIFC
72 ABDACB
73 TRNG
74 PARC
75 CATB
77 TWIM2
78 TWIM3
79 LCDCA

## Licence text in the file
============================================================================ Atmel Microcontroller Software Support ============================================================================ Copyright (c) 2014, Atmel Corporation . All rights reserved. . Redistribution and use in source and binary forms, with or without modification, are permitted provided that the following condition is met: - Redistributions of source code must retain the above copyright notice, this list of conditions and the disclaimer below. . Atmel's name may not be used to endorse or promote products derived from this software without specific prior written permission. . DISCLAIMER: THIS SOFTWARE IS PROVIDED BY ATMEL "AS IS" AND ANY EXPRESS OR. IMPLIED WARRANTIES, INCLUDING, BUT NOT LIMITED TO, THE IMPLIED WARRANTIES OF. MERCHANTABILITY, FITNESS FOR A PARTICULAR PURPOSE AND NON-INFRINGEMENT ARE. DISCLAIMED. IN NO EVENT SHALL ATMEL BE LIABLE FOR ANY DIRECT, INDIRECT, INCIDENTAL, SPECIAL, EXEMPLARY, OR CONSEQUENTIAL DAMAGES (INCLUDING, BUT NOT. LIMITED TO, PROCUREMENT OF SUBSTITUTE GOODS OR SERVICES; LOSS OF USE, DATA, OR PROFITS; OR BUSINESS INTERRUPTION) HOWEVER CAUSED AND ON ANY THEORY OF. LIABILITY, WHETHER IN CONTRACT, STRICT LIABILITY, OR TORT (INCLUDING. NEGLIGENCE OR OTHERWISE) ARISING IN ANY WAY OUT OF THE USE OF THIS SOFTWARE, EVEN IF ADVISED OF THE POSSIBILITY OF SUCH DAMAGE. ============================================================================
