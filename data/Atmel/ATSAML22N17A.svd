# ATSAML22N17A register map
Vendor: Atmel Corporation; Series: SAML22; File version: A
Atmel ATSAML22N17A device: Cortex-M0+ Microcontroller with 128KB Flash, 16KB SRAM, 100-pin package (refer to http://www.atmel.com/devices/SAML22N17A.aspx for more)
CPU: CM0+ r0p1, little endian, MPU, no FPU, VTOR, 2 interrupt priority bits
Registers are 32-bit, read-write, reset 0x0 unless marked. A register's access mark holds for its fields unless they carry their own. Offsets are from the block's base; lines under a group give offsets from that group; [hi:lo] are bit positions; {n}, {i} and the like mark numbered series; 'fields as' and 'values as' point back to an identical list; <NAME> marks a mode.

## Memory map
0x40000000 PAC size 0x80 — Peripheral Access Controller
0x40000400 PM size 0x80 — Power Manager
0x40000800 MCLK size 0x80 — Main Clock
0x40000C00 RSTC size 0x20 — Reset Controller
0x40001000 OSCCTRL size 0x80 — Oscillators Control
0x40001400 OSC32KCTRL size 0x80 — 32k Oscillators Control
0x40001800 SUPC size 0x80 — Supply Controller
0x40001C00 GCLK size 0x200 — Generic Clock Generator
0x40002000 WDT size 0x10 — Watchdog Timer
0x40002400 RTC size 0x100 — Real-Time Counter
0x40002800 EIC size 0x40 — External Interrupt Controller
0x40002C00 FREQM size 0x20 — Frequency Meter
0x40003000 TAL size 0x80 — Trigger Allocator
0x41000000 USB size 0x400 — Universal Serial Bus
0x41002000 DSU size 0x2000 — Device Service Unit
0x41004000 NVMCTRL size 0x80 — Non-Volatile Memory Controller
0x41006000 PORT size 0x200 — Port Module
0x41008000 DMAC size 0x80 — Direct Memory Access Controller
0x4100A000 MTB size 0x1000 — Cortex-M0+ Micro-Trace Buffer
0x42000000 EVSYS size 0x400 — Event System Interface
0x42000400 SERCOM0 size 0x40 — Serial Communication Interface 0
0x42000800 SERCOM1 size 0x40 — Serial Communication Interface 1
0x42000C00 SERCOM2 size 0x40 — Serial Communication Interface 2
0x42001000 SERCOM3 size 0x40 — Serial Communication Interface 3
0x42001400 SERCOM4 size 0x40 — Serial Communication Interface 4
0x42001800 SERCOM5 size 0x40 — Serial Communication Interface 5
0x42001C00 TCC0 size 0x90 — Timer Counter Control
0x42002000 TC0 size 0x40 — Basic Timer Counter 0
0x42002400 TC1 size 0x40 — Basic Timer Counter 1
0x42002800 TC2 size 0x40 — Basic Timer Counter 2
0x42002C00 TC3 size 0x40 — Basic Timer Counter 3
0x42003000 ADC size 0x80 — Analog Digital Converter
0x42003400 AC size 0x40 — Analog Comparators
0x42003C00 SLCD size 0x100 — Segment Liquid Crystal Display Controller
0x42004000 AES size 0x100 — Advanced Encryption Standard
0x42004400 TRNG size 0x100 — True Random Generator
0x42004800 CCL size 0x40 — Configurable Custom Logic

## Interrupts
0 SYSTEM (MCLK, OSCCTRL, OSC32KCTRL, PAC, PM, SUPC, TAL)
1 WDT
2 RTC
3 EIC
4 FREQM
5 USB
6 NVMCTRL
7 DMAC
8 EVSYS
9 SERCOM0
10 SERCOM1
11 SERCOM2
12 SERCOM3
13 SERCOM4
14 SERCOM5
15 TCC0
16 TC0
17 TC1
18 TC2
19 TC3
20 ADC
21 AC
23 SLCD
24 AES
25 TRNG

## Licence text in the file
============================================================================ Atmel Microcontroller Software Support ============================================================================ Copyright (c) 2015, Atmel Corporation . All rights reserved. . Redistribution and use in source and binary forms, with or without modification, are permitted provided that the following condition is met: - Redistributions of source code must retain the above copyright notice, this list of conditions and the disclaimer below. . Atmel's name may not be used to endorse or promote products derived from this software without specific prior written permission. . DISCLAIMER: THIS SOFTWARE IS PROVIDED BY ATMEL "AS IS" AND ANY EXPRESS OR. IMPLIED WARRANTIES, INCLUDING, BUT NOT LIMITED TO, THE IMPLIED WARRANTIES OF. MERCHANTABILITY, FITNESS FOR A PARTICULAR PURPOSE AND NON-INFRINGEMENT ARE. DISCLAIMED. IN NO EVENT SHALL ATMEL BE LIABLE FOR ANY DIRECT, INDIRECT, INCIDENTAL, SPECIAL, EXEMPLARY, OR CONSEQUENTIAL DAMAGES (INCLUDING, BUT NOT. LIMITED TO, PROCUREMENT OF SUBSTITUTE GOODS OR SERVICES; LOSS OF USE, DATA, OR PROFITS; OR BUSINESS INTERRUPTION) HOWEVER CAUSED AND ON ANY THEORY OF. LIABILITY, WHETHER IN CONTRACT, STRICT LIABILITY, OR TORT (INCLUDING. NEGLIGENCE OR OTHERWISE) ARISING IN ANY WAY OUT OF THE USE OF THIS SOFTWARE, EVEN IF ADVISED OF THE POSSIBILITY OF SUCH DAMAGE. ============================================================================
