# MSP432P411Y register map
Vendor: Texas Instruments; File version: 3.230
ARM Cortex-M4 MSP432P4xx Device
Registers are 32-bit, read-write, reset 0x0 unless marked. A register's access mark holds for its fields unless they carry their own. Offsets are from the block's base; lines under a group give offsets from that group; [hi:lo] are bit positions; {n}, {i} and the like mark numbered series; 'fields as' and 'values as' point back to an identical list; <NAME> marks a mode.

## Memory map
0x00201000 TLV size 0x15C
0x40000000 TIMER_A0 size 0x30
0x40000400 TIMER_A1 size 0x30
0x40000800 TIMER_A2 size 0x30
0x40000C00 TIMER_A3 size 0x30
0x40001000 EUSCI_A0 size 0x20
0x40001400 EUSCI_A1 size 0x20
0x40001800 EUSCI_A2 size 0x20
0x40001C00 EUSCI_A3 size 0x20
0x40002000 EUSCI_B0 size 0x30
0x40002400 EUSCI_B1 size 0x30
0x40002800 EUSCI_B2 size 0x30
0x40002C00 EUSCI_B3 size 0x30
0x40003000 REF_A size 0xC
0x40003400 COMP_E0 size 0x10
0x40003800 COMP_E1 size 0x10
0x40003C00 AES256 size 0x10
0x40004000 CRC32 size 0x20
0x40004400 RTC_C size 0x20
0x40004800 WDT_A size 0xE
0x40004C00 DIO size 0x138
0x40005000 PMAP size 0x40
0x40005400 CAPTIO0 size 0x10
0x40005800 CAPTIO1 size 0x10
0x4000C000 TIMER32 size 0xF0C
0x4000E000 DMA size 0x1050
0x40010000 PCM size 0x14
0x40010400 CS size 0x68
0x40010800 PSS size 0x40
0x40011000 FLCTL_A size 0x260
0x40012000 ADC14 size 0x158
0x40012400 LCD_F size 0x1A8
0xE0000000 ITM size 0x1000
0xE0001000 DWT size 0x1000
0xE0002000 FPB size 0x1000
0xE000E000 SystemControlSpace blocks up to offset 0x1000 — System Control Space for ARM core: SCnSCB, SCB, SysTick, NVIC, CoreDebug, MPU, FPU
0xE0042000 RSTCTL size 0x128
0xE0043000 SYSCTL_A size 0x102C

## Interrupts
0 PSS_IRQ (PSS) — PSS Interrupt
1 CS_IRQ (CS) — CS Interrupt
2 PCM_IRQ (PCM) — PCM Interrupt
3 WDT_A_IRQ (WDT_A) — WDT_A Interrupt
4 FPU_IRQ (SystemControlSpace) — FPU Interrupt
5 FLCTL_A_IRQ (FLCTL_A) — Flash Controller Interrupt
6 COMP_E0_IRQ (COMP_E0) — COMP_E0 Interrupt
7 COMP_E1_IRQ (COMP_E1) — COMP_E1 Interrupt
8 TA0_0_IRQ (TIMER_A0) — TA0_0 Interrupt
9 TA0_N_IRQ (TIMER_A0) — TA0_N Interrupt
10 TA1_0_IRQ (TIMER_A1) — TA1_0 Interrupt
11 TA1_N_IRQ (TIMER_A1) — TA1_N Interrupt
12 TA2_0_IRQ (TIMER_A2) — TA2_0 Interrupt
13 TA2_N_IRQ (TIMER_A2) — TA2_N Interrupt
14 TA3_0_IRQ (TIMER_A3) — TA3_0 Interrupt
15 TA3_N_IRQ (TIMER_A3) — TA3_N Interrupt
16 EUSCIA0_IRQ (EUSCI_A0) — EUSCIA0 Interrupt
17 EUSCIA1_IRQ (EUSCI_A1) — EUSCIA1 Interrupt
18 EUSCIA2_IRQ (EUSCI_A2) — EUSCIA2 Interrupt
19 EUSCIA3_IRQ (EUSCI_A3) — EUSCIA3 Interrupt
20 EUSCIB0_IRQ (EUSCI_B0) — EUSCIB0 Interrupt
21 EUSCIB1_IRQ (EUSCI_B1) — EUSCIB1 Interrupt
22 EUSCIB2_IRQ (EUSCI_B2) — EUSCIB2 Interrupt
23 EUSCIB3_IRQ (EUSCI_B3) — EUSCIB3 Interrupt
24 ADC14_IRQ (ADC14) — ADC14 Interrupt
25 T32_INT1_IRQ (TIMER32) — T32_INT1 Interrupt
26 T32_INT2_IRQ (TIMER32) — T32_INT2 Interrupt
27 T32_INTC_IRQ (TIMER32) — T32_INTC Interrupt
28 AES256_IRQ (AES256) — AES256 Interrupt
29 RTC_C_IRQ (RTC_C) — RTC_C Interrupt
30 DMA_ERR_IRQ (DMA) — DMA_ERR Interrupt
31 DMA_INT3_IRQ (DMA) — DMA_INT3 Interrupt
32 DMA_INT2_IRQ (DMA) — DMA_INT2 Interrupt
33 DMA_INT1_IRQ (DMA) — DMA_INT1 Interrupt
34 DMA_INT0_IRQ (DMA) — DMA_INT0 Interrupt
35 PORT1_IRQ (DIO) — Port1 Interrupt
36 PORT2_IRQ (DIO) — Port2 Interrupt
37 PORT3_IRQ (DIO) — Port3 Interrupt
38 PORT4_IRQ (DIO) — Port4 Interrupt
39 PORT5_IRQ (DIO) — Port5 Interrupt
40 PORT6_IRQ (DIO) — Port6 Interrupt
41 LCD_F_IRQ (LCD_F) — LCD_F Interrupt

## Licence text in the file
Copyright (C) 2012-2018 Texas Instruments Incorporated - http://www.ti.com/ . Redistribution and use in source and binary forms, with or without modification, are permitted provided that the following conditions are met: Redistributions of source code must retain the above copyright notice, this list of conditions and the following disclaimer. . Redistributions in binary form must reproduce the above copyright notice, this list of conditions and the following disclaimer in the documentation and/or other materials provided with the distribution. . Neither the name of Texas Instruments Incorporated nor the names of its contributors may be used to endorse or promote products derived from this software without specific prior written permission. . THIS SOFTWARE IS PROVIDED BY THE COPYRIGHT HOLDERS AND CONTRIBUTORS "AS IS" AND ANY EXPRESS OR IMPLIED WARRANTIES, INCLUDING, BUT NOT. LIMITED TO, THE IMPLIED WARRANTIES OF MERCHANTABILITY AND FITNESS FOR. A PARTICULAR PURPOSE ARE DISCLAIMED. IN NO EVENT SHALL THE COPYRIGHT. OWNER OR CONTRIBUTORS BE LIABLE FOR ANY DIRECT, INDIRECT, INCIDENTAL, SPECIAL, EXEMPLARY, OR CONSEQUENTIAL DAMAGES (INCLUDING, BUT NOT. LIMITED TO, PROCUREMENT OF SUBSTITUTE GOODS OR SERVICES; LOSS OF USE, DATA, OR PROFITS; OR BUSINESS INTERRUPTION) HOWEVER CAUSED AND ON ANY. THEORY OF LIABILITY, WHETHER IN CONTRACT, STRICT LIABILITY, OR TORT (INCLUDING NEGLIGENCE OR OTHERWISE) ARISING IN ANY WAY OUT OF THE USE. OF THIS SOFTWARE, EVEN IF ADVISED OF THE POSSIBILITY OF SUCH DAMAGE.
