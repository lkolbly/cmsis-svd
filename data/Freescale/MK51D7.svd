# MK51D7 register map
File version: 1.6
MK51D7 Freescale Microcontroller
Registers are 32-bit, read-write, reset 0x0 unless marked. A register's access mark holds for its fields unless they carry their own. Offsets are from the block's base; lines under a group give offsets from that group; [hi:lo] are bit positions; {n}, {i} and the like mark numbered series; 'fields as' and 'values as' point back to an identical list; <NAME> marks a mode.

## Memory map
0x00000400 FTFL_FlashConfig size 0x10 — Flash configuration field
0x40000000 AIPS0 size 0x70 — AIPS-Lite Bridge
0x40004000 AXBS size 0xB04 — Crossbar switch
0x40008000 DMA size 0x1200 — Enhanced direct memory access controller
0x4001F000 FMC size 0x300 — Flash Memory Controller
0x40020000 FTFL size 0x18 — Flash Memory Interface
0x40021000 DMAMUX size 0x10 — DMA channel multiplexor
0x4002C000 SPI0 size 0x8C — Deserial Serial Peripheral Interface
0x4002D000 SPI1 size 0x8C — Deserial Serial Peripheral Interface
0x4002F000 I2S0 size 0x108 — Inter-IC Sound / Synchronous Audio Interface
0x40032000 CRC size 0xC — Cyclic Redundancy Check
0x40035000 USBDCD size 0x1C — USB Device Charger Detection module
0x40036000 PDB0 size 0x1A0 — Programmable Delay Block
0x40037000 PIT size 0x140 — Periodic Interrupt Timer
0x40038000 FTM0 size 0x9C — FlexTimer Module
0x40039000 FTM1 size 0x9C — FlexTimer Module
0x4003B000 ADC0 size 0x70 — Analog-to-Digital Converter
0x4003D000 RTC size 0x808 — Secure Real Time Clock
0x4003E000 RFVBAT size 0x20 — VBAT register file
0x40040000 LPTMR0 size 0x10 — Low Power Timer
0x40041000 RFSYS size 0x20 — System register file
0x40045000 TSI0 size 0x124 — Touch Sensing Input
0x40047000 SIM size 0x1064 — System Integration Module
0x40049000 PORTA size 0xCC — Pin Control and Interrupts
0x4004A000 PORTB size 0xCC — Pin Control and Interrupts
0x4004B000 PORTC size 0xCC — Pin Control and Interrupts
0x4004C000 PORTD size 0xCC — Pin Control and Interrupts
0x4004D000 PORTE size 0xCC — Pin Control and Interrupts
0x40052000 WDOG size 0x18 — Generation 2008 Watchdog Timer
0x40061000 EWM size 0x4 — External Watchdog Monitor
0x40062000 CMT size 0xC — Carrier Modulator Transmitter
0x40064000 MCG size 0xE — Multipurpose Clock Generator module
0x40065000 OSC size 0x1 — Oscillator
0x40066000 I2C0 size 0xC — Inter-Integrated Circuit
0x40067000 I2C1 size 0xC — Inter-Integrated Circuit
0x4006A000 UART0 size 0x20 — Serial Communication Interface
0x4006B000 UART1 size 0x17 — Serial Communication Interface
0x4006C000 UART2 size 0x17 — Serial Communication Interface
0x4006D000 UART3 size 0x17 — Serial Communication Interface
0x40072000 USB0 size 0x115 — Universal Serial Bus, OTG Capable Controller
0x40073000 CMP0 size 0x6 — High-Speed Comparator (CMP), Voltage Reference (VREF) Digital-to-Analog Converter (DAC), and Analog Mux (ANMUX)
0x40073008 CMP1 size 0x6 — High-Speed Comparator (CMP), Voltage Reference (VREF) Digital-to-Analog Converter (DAC), and Analog Mux (ANMUX)
0x40073010 CMP2 size 0x6 — High-Speed Comparator (CMP), Voltage Reference (VREF) Digital-to-Analog Converter (DAC), and Analog Mux (ANMUX)
0x40074000 VREF size 0x2 — Voltage Reference
0x4007C000 LLWU size 0xB — Low leakage wakeup unit
0x4007D000 PMC size 0x3 — Power Management Controller
0x4007E000 SMC size 0x4 — System Mode Controller
0x4007F000 RCM size 0x8 — Reset Control Module
0x40080000 AIPS1 size 0x70 — AIPS-Lite Bridge
0x400B8000 FTM2 size 0x9C — FlexTimer Module
0x400BB000 ADC1 size 0x70 — Analog-to-Digital Converter
0x400BE000 LCD size 0x60 — Segment Liquid Crystal Display
0x400CC000 DAC0 size 0x24 — 12-Bit Digital-to-Analog Converter
0x400EA000 UART4 size 0x17 — Serial Communication Interface
0x400F5000 OPAMP0 size 0x3 — General Purpose Operational Amplifier
0x400F5800 OPAMP1 size 0x3 — General Purpose Operational Amplifier
0x400F8000 TRIAMP0 size 0x1 — Trans-Impedance Amplifier
0x400FF000 PTA size 0x18 — General Purpose Input/Output
0x400FF040 PTB size 0x18 — General Purpose Input/Output
0x400FF080 PTC size 0x18 — General Purpose Input/Output
0x400FF0C0 PTD size 0x18 — General Purpose Input/Output
0x400FF100 PTE size 0x18 — General Purpose Input/Output
0xE0080000 MCM blocks up to offset 0x10 — Core Platform Miscellaneous Control Module

## Interrupts
{n} INT_DMA{n} (DMA) (n=0..15)
16 INT_DMA_Error (DMA)
18 INT_FTFL (FTFL)
19 INT_Read_Collision (FTFL)
20 INT_LVD_LVW (PMC)
21 INT_LLW (LLWU)
22 INT_Watchdog (WDOG, EWM)
24 INT_I2C0 (I2C0)
25 INT_I2C1 (I2C1)
26 INT_SPI0 (SPI0)
27 INT_SPI1 (SPI1)
35 INT_I2S0_Tx (I2S0)
36 INT_I2S0_Rx (I2S0)
44 INT_UART0_LON (UART0)
45 INT_UART0_RX_TX (UART0)
46 INT_UART0_ERR (UART0)
47 INT_UART1_RX_TX (UART1)
48 INT_UART1_ERR (UART1)
49 INT_UART2_RX_TX (UART2)
50 INT_UART2_ERR (UART2)
51 INT_UART3_RX_TX (UART3)
52 INT_UART3_ERR (UART3)
53 INT_UART4_RX_TX (UART4)
54 INT_UART4_ERR (UART4)
57 INT_ADC0 (ADC0)
58 INT_ADC1 (ADC1)
59 INT_CMP0 (CMP0)
60 INT_CMP1 (CMP1)
61 INT_CMP2 (CMP2)
62 INT_FTM0 (FTM0)
63 INT_FTM1 (FTM1)
64 INT_FTM2 (FTM2)
65 INT_CMT (CMT)
66 INT_RTC (RTC)
67 INT_RTC_Seconds (RTC)
68 INT_PIT0 (PIT)
69 INT_PIT1 (PIT)
70 INT_PIT2 (PIT)
71 INT_PIT3 (PIT)
72 INT_PDB0 (PDB0)
73 INT_USB0 (USB0)
74 INT_USBDCD (USBDCD)
79 INT_Reserved95 (I2S0)
81 INT_DAC0 (DAC0)
83 INT_TSI0 (TSI0)
85 INT_LPTimer (LPTMR0)
86 INT_LCD (LCD)
87 INT_PORTA (PTA)
88 INT_PORTB (PTB)
89 INT_PORTC (PTC)
90 INT_PORTD (PTD)
91 INT_PORTE (PTE)
