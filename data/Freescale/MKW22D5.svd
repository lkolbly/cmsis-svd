# MKW22D5 register map
File version: 1.6
MKW22D5 Freescale Microcontroller
Registers are 32-bit, read-write, reset 0x0 unless marked. A register's access mark holds for its fields unless they carry their own. Offsets are from the block's base; lines under a group give offsets from that group; [hi:lo] are bit positions; {n}, {i} and the like mark numbered series; 'fields as' and 'values as' point back to an identical list; <NAME> marks a mode.

## Memory map
0x00000400 FTFL_FlashConfig size 0x10 — Flash configuration field
0x40008000 DMA size 0x1200 — Enhanced direct memory access controller
0x4001F000 FMC size 0x240 — Flash Memory Controller
0x40020000 FTFL size 0x18 — Flash Memory Interface
0x40021000 DMAMUX size 0x10 — DMA channel multiplexor
0x40029000 RNG size 0x10 — Random Number Generator Accelerator
0x4002C000 SPI0 size 0x8C — Serial Peripheral Interface
0x4002D000 SPI1 size 0x8C — Serial Peripheral Interface
0x4002F000 I2S0 size 0x108 — Inter-IC Sound / Synchronous Audio Interface
0x40032000 CRC size 0xC — Cyclic Redundancy Check
0x40035000 USBDCD size 0x1C — USB Device Charger Detection module
0x40036000 PDB0 size 0x19C — Programmable Delay Block
0x40037000 PIT size 0x140 — Periodic Interrupt Timer
0x40038000 FTM0 size 0x9C — FlexTimer Module
0x40039000 FTM1 size 0x9C — FlexTimer Module
0x4003A000 FTM2 size 0x9C — FlexTimer Module
0x4003B000 ADC0 size 0x70 — Analog-to-Digital Converter
0x4003D000 RTC size 0x808 — Secure Real Time Clock
0x4003F000 DAC0 size 0x24 — 12-Bit Digital-to-Analog Converter
0x40040000 LPTMR0 size 0x10 — Low Power Timer
0x40047000 SIM size 0x1064 — System Integration Module
0x40049000 PORTA size 0xCC — Pin Control and Interrupts
0x4004A000 PORTB size 0xCC — Pin Control and Interrupts
0x4004B000 PORTC size 0xCC — Pin Control and Interrupts
0x4004C000 PORTD size 0xCC — Pin Control and Interrupts
0x4004D000 PORTE size 0xCC — Pin Control and Interrupts
0x40052000 WDOG size 0x18 — Generation 2008 Watchdog Timer
0x40061000 EWM size 0x4 — External Watchdog Monitor
0x40062000 CMT size 0xC — Carrier Modulator Transmitter
0x40064000 MCG size 0x10 — Multipurpose Clock Generator module
0x40065000 OSC size 0x1 — Oscillator
0x40066000 I2C0 size 0xC — Inter-Integrated Circuit
0x40067000 I2C1 size 0xC — Inter-Integrated Circuit
0x4006A000 UART0 size 0x20 — Serial Communication Interface
0x4006B000 UART1 size 0x17 — Serial Communication Interface
0x4006C000 UART2 size 0x17 — Serial Communication Interface
0x40072000 USB0 size 0x115 — Universal Serial Bus, OTG Capable Controller
0x40073000 CMP0 size 0x6 — High-Speed Comparator (CMP), Voltage Reference (VREF) Digital-to-Analog Converter (DAC), and Analog Mux (ANMUX)
0x40073008 CMP1 size 0x6 — High-Speed Comparator (CMP), Voltage Reference (VREF) Digital-to-Analog Converter (DAC), and Analog Mux (ANMUX)
0x4007C000 LLWU size 0xB — Low leakage wakeup unit
0x4007D000 PMC size 0x3 — Power Management Controller
0x4007E000 SMC size 0x4 — System Mode Controller
0x4007F000 RCM size 0x8 — Reset Control Module
0x400FF000 GPIOA size 0x18 — General Purpose Input/Output
0x400FF040 GPIOB size 0x18 — General Purpose Input/Output
0x400FF080 GPIOC size 0x18 — General Purpose Input/Output
0x400FF0C0 GPIOD size 0x18 — General Purpose Input/Output
0x400FF100 GPIOE size 0x18 — General Purpose Input/Output
0xE0080000 MCM blocks up to offset 0x10 — Core Platform Miscellaneous Control Module
0xE0081000 CAU size 0xB6C — Memory Mapped Cryptographic Acceleration Unit (MMCAU)

## Interrupts
{n} INT_DMA{n} (DMA) (n=0..15)
16 INT_DMA_Error (DMA)
17 INT_MCM (MCM)
18 INT_FTFL (FTFL)
19 INT_FTFL_Collision (FTFL)
20 INT_PMC (PMC)
21 INT_LLWU (LLWU)
22 INT_WDOG_EWM (WDOG, EWM)
23 INT_RNG (RNG)
24 INT_I2C0 (I2C0)
25 INT_I2C1 (I2C1)
26 INT_SPI0 (SPI0)
27 INT_SPI1 (SPI1)
28 INT_I2S0_Tx (I2S0)
29 INT_I2S0_Rx (I2S0)
31 INT_UART0_RX_TX (UART0)
32 INT_UART0_ERR (UART0)
33 INT_UART1_RX_TX (UART1)
34 INT_UART1_ERR (UART1)
35 INT_UART2_RX_TX (UART2)
36 INT_UART2_ERR (UART2)
39 INT_ADC0 (ADC0)
40 INT_CMP0 (CMP0)
41 INT_CMP1 (CMP1)
42 INT_FTM0 (FTM0)
43 INT_FTM1 (FTM1)
44 INT_FTM2 (FTM2)
45 INT_CMT (CMT)
46 INT_RTC (RTC)
47 INT_RTC_Seconds (RTC)
48 INT_PIT0 (PIT)
49 INT_PIT1 (PIT)
50 INT_PIT2 (PIT)
51 INT_PIT3 (PIT)
52 INT_PDB0 (PDB0)
53 INT_USB0 (USB0)
54 INT_USBDCD (USBDCD)
56 INT_DAC0 (DAC0)
57 INT_MCG (MCG)
58 INT_LPTMR0 (LPTMR0)
59 INT_PORTA (PORTA, GPIOA)
60 INT_PORTB (PORTB, GPIOB)
61 INT_PORTC (PORTC, GPIOC)
62 INT_PORTD (PORTD, GPIOD)
63 INT_PORTE (PORTE, GPIOE)
